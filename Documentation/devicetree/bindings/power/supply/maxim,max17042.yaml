## Documentation/devicetree/bindings/power/supply/maxim,max17042.yaml
```yaml
# SPDX-License-Identifier: GPL-2.0
%YAML 1.2
---
$id: http://devicetree.org/schemas/power/supply/maxim,max17042.yaml#
$schema: http://devicetree.org/meta-schemas/core.yaml#

title: Maxim 17042 fuel gauge series

maintainers:
  - Sebastian Reichel <sre@kernel.org>

allOf:
  - $ref: power-supply.yaml#
  - if:
      properties:
        compatible:
          contains:
            const: maxim,max77865-battery
    then:
      required:
        - samsung,battery-ntc
        - samsung,capacity-max
        - samsung,capacity-max-margin
        - samsung,capacity-min
        - samsung,full-condition-microvolt
        - samsung,full-condition-percent
        - samsung,recharge-condition-microvolt
    else:
      properties:
        samsung,battery-ntc: false
        samsung,capacity-max: false
        samsung,capacity-max-margin: false
        samsung,capacity-min: false
        samsung,full-condition-microvolt: false
        samsung,full-condition-percent: false
        samsung,recharge-condition-microvolt: false
        maxim,ttf-cv-data: false

properties:
  compatible:
    enum:
      - maxim,max17042
      - maxim,max17047
      - maxim,max17050
      - maxim,max17055
      - maxim,max77705-battery
      - maxim,max77849-battery
      - maxim,max77865-battery

  reg:
    maxItems: 1

  interrupts:
    maxItems: 1
    description: |
      The ALRT pin, an open-drain interrupt.

  maxim,rsns-microohm:
    $ref: /schemas/types.yaml#/definitions/uint32
    description: |
      Resistance of rsns resistor in micro Ohms (datasheet-recommended value is 10000).
      Defining this property enables current-sense functionality.

  maxim,cold-temp:
    $ref: /schemas/types.yaml#/definitions/uint32
    description: |
      Temperature threshold to report battery as cold (in tenths of degree Celsius).
      Default is not to report cold events.

  maxim,over-heat-temp:
    $ref: /schemas/types.yaml#/definitions/uint32
    description: |
      Temperature threshold to report battery as over heated (in tenths of degree Celsius).
      Default is not to report over heating events.

  maxim,dead-volt:
    $ref: /schemas/types.yaml#/definitions/uint32
    description: |
      Voltage threshold to report battery as dead (in mV).
      Default is not to report dead battery events.

  maxim,over-volt:
    $ref: /schemas/types.yaml#/definitions/uint32
    description: |
      Voltage threshold to report battery as over voltage (in mV).
      Default is not to report over-voltage events.

  power-supplies: true
  monitored-battery: true

  samsung,battery-ntc:
    $ref: /schemas/types.yaml#/definitions/string
    description:
      maxim,max77865-battery only. Type of the thermal zone (battery NTC) whose
      temperature the driver writes to the TEMP register; required for that
      compatible, whose temperature is host-written (CONFIG.TEX set).

  samsung,capacity-max:
    $ref: /schemas/types.yaml#/definitions/uint32
    maximum: 1000
    description:
      maxim,max77865-battery only. Gauge state of charge, in tenths of a
      percent, that is reported as 100 %. The driver lowers it at the end of a
      charge when the gauge stops short of 100 %; this is its upper bound.

  samsung,capacity-max-margin:
    $ref: /schemas/types.yaml#/definitions/uint32
    description:
      maxim,max77865-battery only. How far below samsung,capacity-max the
      learned value may go, in tenths of a percent.

  samsung,capacity-min:
    $ref: /schemas/types.yaml#/definitions/uint32
    description:
      maxim,max77865-battery only. Gauge state of charge, in tenths of a
      percent, that is reported as 0 %.

  samsung,full-condition-microvolt:
    description:
      maxim,max77865-battery only. Minimum cell voltage for the end of charge
      the charger signals to count as a full battery.

  samsung,full-condition-percent:
    $ref: /schemas/types.yaml#/definitions/uint32
    maximum: 100
    description:
      maxim,max77865-battery only. A full battery is reported as charging
      again once its capacity falls below this value and its cell voltage
      below samsung,recharge-condition-microvolt minus 50 mV.

  samsung,recharge-condition-microvolt:
    description:
      maxim,max77865-battery only. Cell voltage at which the charger restarts
      a full battery; see samsung,full-condition-percent.

  maxim,ttf-cv-data:
    $ref: /schemas/types.yaml#/definitions/uint32-matrix
    items:
      items:
        - description: charge current in mA
        - description: state of charge in tenths of a percent
        - description: time to full in seconds
    description:
      maxim,max77865-battery only. The constant-voltage table of the
      time-to-full estimate, rows in falling charge current.

required:
  - compatible
  - reg

additionalProperties: false

examples:
  - |
    i2c {
      #address-cells = <1>;
      #size-cells = <0>;

      battery@36 {
        compatible = "maxim,max17042";
        reg = <0x36>;
        maxim,rsns-microohm = <10000>;
        maxim,over-heat-temp = <600>;
        maxim,over-volt = <4300>;
      };
    };
```

## Documentation/devicetree/bindings/power/supply/maxim,max77865.yaml
```yaml
# SPDX-License-Identifier: (GPL-2.0-only OR BSD-2-Clause)
%YAML 1.2
---
$id: http://devicetree.org/schemas/power/supply/maxim,max77865.yaml#
$schema: http://devicetree.org/meta-schemas/core.yaml#

title: Maxim MAX77865 charger

maintainers:
  - nhansp <nhan.094.vn@gmail.com>

description: |
  Charger page (I2C address 0x69) of the Maxim MAX77865 companion PMIC. Its
  interrupt is the charger source (0) of the maxim,max77865 top-level node.
  Without samsung,charge-control the driver only monitors (it writes no
  charger configuration register); with it, the driver programs the charger
  and runs the charge policy.

allOf:
  - $ref: power-supply.yaml#

properties:
  compatible:
    const: maxim,max77865-charger

  reg:
    maxItems: 1

  interrupts:
    maxItems: 1

  samsung,battery-ntc:
    $ref: /schemas/types.yaml#/definitions/string
    description: Type of the thermal zone of the battery NTC thermistor.

  samsung,pmu:
    $ref: /schemas/types.yaml#/definitions/phandle
    description:
      The Exynos PMU system controller, for the power-off-with-charger restart
      into LP charging (INFORM2 and SWRESET writes).

  maxim,pmic:
    $ref: /schemas/types.yaml#/definitions/phandle
    description: The maxim,max77865 top-level node (MAINCTRL1 write).

  jig-gpios:
    maxItems: 1
    description: JIG cable detect input; selects the fuel-gauge power source.

  samsung,charge-control:
    type: boolean
    description: Program the charger and run the charge policy.

  usb-otg-vbus:
    type: object
    $ref: /schemas/regulator/regulator.yaml#
    unevaluatedProperties: false
    description: The USB OTG VBUS boost output (5.02 V).

required:
  - compatible
  - reg
  - interrupts
  - samsung,battery-ntc
  - samsung,pmu

unevaluatedProperties: false

examples:
  - |
    #include <dt-bindings/gpio/gpio.h>

    i2c {
        #address-cells = <1>;
        #size-cells = <0>;

        charger@69 {
            compatible = "maxim,max77865-charger";
            reg = <0x69>;
            interrupt-parent = <&pmic_max77865>;
            interrupts = <0>;
            samsung,battery-ntc = "battery-ntc";
            samsung,pmu = <&pmu_system_controller>;
            maxim,pmic = <&pmic_max77865>;
            jig-gpios = <&gpi1 4 GPIO_ACTIVE_LOW>;
            samsung,charge-control;

            usb-otg-vbus {
                regulator-name = "usb_otg_vbus";
                regulator-min-microvolt = <5020000>;
                regulator-max-microvolt = <5020000>;
            };
        };
    };
```

## Documentation/devicetree/bindings/regulator/samsung,s2dos03.yaml
```yaml
# SPDX-License-Identifier: (GPL-2.0-only OR BSD-2-Clause)
%YAML 1.2
---
$id: http://devicetree.org/schemas/regulator/samsung,s2dos03.yaml#
$schema: http://devicetree.org/meta-schemas/core.yaml#

title: Samsung S2DOS03 display power regulator

maintainers:
  - Krzysztof Kozlowski <krzk@kernel.org>

description: |
  The S2DOS03 is an I2C power management IC with four LDOs (ldo1..ldo4) and
  one buck converter (buck1), used on Exynos 8895 phones to supply the
  display panel. LDOs cover 0.6 V to 3.775 V in 25 mV steps, the buck
  0.5 V to 2.09375 V in 6.25 mV steps.

properties:
  compatible:
    const: samsung,s2dos03

  reg:
    maxItems: 1

  regulators:
    type: object
    description: List of regulators and their properties.

    patternProperties:
      "^(ldo[1-4]|buck1)$":
        type: object
        $ref: regulator.yaml#
        unevaluatedProperties: false

    additionalProperties: false

required:
  - compatible
  - reg
  - regulators

additionalProperties: false

examples:
  - |
    i2c {
        #address-cells = <1>;
        #size-cells = <0>;

        pmic@60 {
            compatible = "samsung,s2dos03";
            reg = <0x60>;

            regulators {
                buck1 {
                    regulator-name = "vdd_ddi_1p6";
                    regulator-min-microvolt = <1500000>;
                    regulator-max-microvolt = <1600000>;
                    regulator-boot-on;
                };

                ldo1 {
                    regulator-name = "vdd_ddi_1p8";
                    regulator-min-microvolt = <1800000>;
                    regulator-max-microvolt = <1800000>;
                    regulator-boot-on;
                };

                ldo3 {
                    regulator-name = "vdd_ddi_3p0";
                    regulator-min-microvolt = <3000000>;
                    regulator-max-microvolt = <3000000>;
                    regulator-boot-on;
                };
            };
        };
    };
```

## Documentation/devicetree/bindings/regulator/samsung,s2mps17.yaml
```yaml
# SPDX-License-Identifier: GPL-2.0-only OR BSD-2-Clause
%YAML 1.2
---
$id: http://devicetree.org/schemas/regulator/samsung,s2mps17.yaml#
$schema: http://devicetree.org/meta-schemas/core.yaml#

title: Samsung S2MPS17 Power Management IC regulators

maintainers:
  - Krzysztof Kozlowski <krzk@kernel.org>

description: |
  This is a part of device tree bindings for S2M and S5M family of Power
  Management IC (PMIC).

  The S2MPS17 provides buck and LDO regulators. It is the main PMIC of
  Exynos8895 boards and is reached through the ACPM firmware.

  The regulator-initial-mode values are the PMIC operating modes: 1 = on
  while PWREN is high (standby), 2 = on while PWREN_MIF is high, 3 (and 0)
  = on. A regulator with an initial mode is switched on in that mode when
  it is registered.

  See also Documentation/devicetree/bindings/mfd/samsung,s2mps11.yaml for
  additional information.

patternProperties:
  # 29 LDOs
  "^LDO([1-9]|1[0-3]|20|29|3[0-9]|4[0-3])$":
    type: object
    $ref: regulator.yaml#
    unevaluatedProperties: false
    description:
      Properties for single LDO regulator.

    properties:
      regulator-initial-mode:
        enum: [0, 1, 2, 3]

    required:
      - regulator-name

  # 12 bucks
  "^BUCK([1-9]|1[0-2])$":
    type: object
    $ref: regulator.yaml#
    unevaluatedProperties: false
    description:
      Properties for single BUCK regulator.

    properties:
      regulator-initial-mode:
        enum: [0, 1, 2, 3]

    required:
      - regulator-name

additionalProperties: false
```

## Documentation/devicetree/bindings/rng/samsung,exynos5250-trng.yaml
```yaml
# SPDX-License-Identifier: (GPL-2.0 OR BSD-2-Clause)
%YAML 1.2
---
$id: http://devicetree.org/schemas/rng/samsung,exynos5250-trng.yaml#
$schema: http://devicetree.org/meta-schemas/core.yaml#

title: Samsung Exynos SoC True Random Number Generator

maintainers:
  - Krzysztof Kozlowski <krzk@kernel.org>
  - Łukasz Stelmach <l.stelmach@samsung.com>

properties:
  compatible:
    enum:
      - samsung,exynos5250-trng
      - samsung,exynos850-trng
      - samsung,exynos8895-trng

  clocks:
    minItems: 1
    maxItems: 2

  clock-names:
    minItems: 1
    maxItems: 2

  reg:
    maxItems: 1

required:
  - compatible

allOf:
  - if:
      properties:
        compatible:
          contains:
            const: samsung,exynos850-trng

    then:
      properties:
        clocks:
          items:
            - description: SSS (Security Sub System) operating clock
            - description: SSS (Security Sub System) bus clock

        clock-names:
          items:
            - const: secss
            - const: pclk

    else:
      properties:
        clocks:
          items:
            - description: SSS (Security Sub System) operating clock

        clock-names:
          items:
            - const: secss

  - if:
      properties:
        compatible:
          contains:
            const: samsung,exynos8895-trng

    # Owned by the secure world and reached only through the SMC_CMD_RANDOM
    # secure monitor call: no register window and no clocks.
    then:
      properties:
        clocks: false
        clock-names: false
        reg: false

    else:
      required:
        - clocks
        - clock-names
        - reg

additionalProperties: false

examples:
  - |
    #include <dt-bindings/clock/exynos5250.h>

    rng@10830600 {
        compatible = "samsung,exynos5250-trng";
        reg = <0x10830600 0x100>;
        clocks = <&clock CLK_SSS>;
        clock-names = "secss";
    };

  - |
    rng {
        compatible = "samsung,exynos8895-trng";
    };
```

## Documentation/devicetree/bindings/sensorhub/samsung,bcm4773-ssp.txt
```
Samsung SSP sensor hub on the Broadcom BCM4773/BCM4774 GNSS + sensor-hub combo
==============================================================================

The BCM4774 of the Galaxy Note 8 (SM-N950N) is a GNSS receiver with an
integrated sensor-hub MCU, reached over SPI with the Broadcom BBD transport
(drivers/sensorhub/brcm/bbdpl/) and the Samsung SSP protocol on top
(drivers/sensorhub/brcm/). The transplanted SSP parser reads the stock ssp-*
property names below.

Required properties:
- compatible: "samsung,bcm4773-ssp"
- reg: chip select, 0
- spi-max-frequency: 26000000
- spi-cpol, spi-cpha: SPI mode 3
- host-req-gpios: host request line from the hub (level-high interrupt)
- mcu-req-gpios: AP -> MCU wake request (output)
- mcu-resp-gpios: MCU -> AP wake response (input)
- batch-wake-gpios: batching wake-up line from the hub (falling edge)
- vdd-mcu-1p8-supply: the 1.8 V rail of the hub MCU (switched by userspace
  through /sys/class/sec/sensorhub/mcu_power)
- ssp-acc-position, ssp-mag-position: accelerometer and magnetometer
  mounting positions (0..7)
- ssp-ap-rev: board revision handed to the hub
- ssp-mag-array: magnetometer compensation matrix (bytes)
- ssp-mag-type, ssp-glass-type: magnetometer and cover-glass type

Optional properties:
- ssp-sns-combination: sensor combination (not used by the driver)
- ssp-pwr-en-gpios: hub power enable (absent on this board)
- pinctrl-names, pinctrl-0: "default" state of the four hub lines
- controller-data: SPI controller data (samsung,spi-feedback-delay)

Example: arch/arm64/boot/dts/exynos/exynos8895-greatlte-l6c.dtsi.
```
