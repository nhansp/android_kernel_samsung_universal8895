## drivers/gpu/drm/exynos/Kconfig
```kconfig
# SPDX-License-Identifier: GPL-2.0-only
config DRM_EXYNOS
	tristate "DRM Support for Samsung SoC Exynos Series"
	depends on OF && DRM && COMMON_CLK
	depends on ARCH_S3C64XX || ARCH_S5PV210 || ARCH_EXYNOS || COMPILE_TEST
	depends on MMU
	select DRM_CLIENT_SELECTION
	select DRM_DISPLAY_HELPER if DRM_EXYNOS_DP
	select DRM_KMS_HELPER
	select VIDEOMODE_HELPERS
	select FB_DMAMEM_HELPERS if DRM_FBDEV_EMULATION
	select SND_SOC_HDMI_CODEC if SND_SOC
	help
	  Choose this option if you have a Samsung SoC Exynos chipset.
	  If M is selected the module will be called exynosdrm.

if DRM_EXYNOS

comment "CRTCs"

config DRM_EXYNOS_FIMD
	bool "FIMD"
	depends on !FB_S3C
	select MFD_SYSCON
	help
	  Choose this option if you want to use Exynos FIMD for DRM.

config DRM_EXYNOS5433_DECON
	bool "DECON on Exynos5433"
	help
	  Choose this option if you want to use Exynos5433 DECON for DRM.

config DRM_EXYNOS7_DECON
	bool "DECON on Exynos7"
	depends on !FB_S3C
	help
	  Choose this option if you want to use Exynos DECON for DRM.

config DRM_EXYNOS_MIXER
	bool "Mixer"
	help
	  Choose this option if you want to use Exynos Mixer for DRM.

config DRM_EXYNOS_VIDI
	bool "Virtual Display"
	help
	  Choose this option if you want to use Exynos VIDI for DRM.

config DRM_EXYNOS8895_DECON
	bool "DECON0 with DPP/DMA on Exynos8895"
	depends on ARCH_EXYNOS || COMPILE_TEST
	select MFD_SYSCON
	select APERTURE_HELPERS
	help
	  Choose this option if you want to use the Exynos8895 DECON0 and its
	  DPP/IDMA channels for DRM, as one CRTC with DSC for a MIPI DSI
	  command-mode panel. The DECON blends up to six windows, one for each
	  DPP channel, and takes over the display the boot loader left running.

config DRM_EXYNOS8895_DECON_HIBER
	bool "Hibernate DECON0 and DSIM0 between frames on Exynos8895"
	depends on DRM_EXYNOS8895_DECON
	help
	  Power the DECON and the DSIM down between frames on a static
	  screen and power them back on for the next frame. This needs the
	  one-shot trigger of the S3CFB front-end; without it the pipe
	  never idles and hibernation never engages.

config DRM_EXYNOS8895_S3CFB
	bool "S3CFB fbdev front-end of the vendor composer on the Exynos8895 DECON0"
	depends on DRM_EXYNOS8895_DECON && FB && FB_DEVICE
	select DRM_CLIENT
	help
	  Choose this option to serve the fbdev interface of the Samsung
	  vendor DECON driver (/dev/fb0 with S3CFB_WIN_CONFIG and sync
	  fences, and the vsync and psr_info files of 12860000.decon_f) to
	  the vendor hwcomposer, as an in-kernel client of the Exynos8895
	  DECON0 CRTC. The DRM fbdev emulation is then not set up.

comment "Encoders and Bridges"

config DRM_EXYNOS_DPI
	bool "Parallel output"
	depends on DRM_EXYNOS_FIMD
	select DRM_PANEL
	default n
	help
	  This enables support for Exynos parallel output.

config DRM_EXYNOS_DSI
	bool "MIPI-DSI host"
	depends on DRM_EXYNOS_FIMD || DRM_EXYNOS5433_DECON || DRM_EXYNOS7_DECON || \
		   DRM_EXYNOS8895_DECON
	select DRM_MIPI_DSI
	select DRM_PANEL
	select DRM_SAMSUNG_DSIM
	default n
	help
	  This enables support for Exynos MIPI-DSI device.

config DRM_EXYNOS_DP
	bool "Exynos specific extensions for Analogix DP driver"
	depends on DRM_EXYNOS_FIMD || DRM_EXYNOS7_DECON
	select DRM_ANALOGIX_DP
	select DRM_DISPLAY_DP_HELPER
	default DRM_EXYNOS
	select DRM_PANEL
	help
	  This enables support for DP device.

config DRM_EXYNOS_HDMI
	bool "HDMI"
	depends on DRM_EXYNOS_MIXER || DRM_EXYNOS5433_DECON
	select CEC_CORE if CEC_NOTIFIER
	help
	  Choose this option if you want to use Exynos HDMI for DRM.

config DRM_EXYNOS_MIC
	bool "Mobile Image Compressor"
	depends on DRM_EXYNOS5433_DECON
	help
	  Choose this option if you want to use Exynos MIC for DRM.

comment "Sub-drivers"

config DRM_EXYNOS_G2D
	bool "G2D"
	depends on VIDEO_SAMSUNG_S5P_G2D=n || COMPILE_TEST
	help
	  Choose this option if you want to use Exynos G2D for DRM.

config DRM_EXYNOS_IPP
	bool

config DRM_EXYNOS_FIMC
	bool "FIMC"
	select DRM_EXYNOS_IPP
	help
	  Choose this option if you want to use Exynos FIMC for DRM.

config DRM_EXYNOS_ROTATOR
	bool "Rotator"
	select DRM_EXYNOS_IPP
	help
	  Choose this option if you want to use Exynos Rotator for DRM.

config DRM_EXYNOS_SCALER
	bool "Scaler"
	select DRM_EXYNOS_IPP
	help
	  Choose this option if you want to use Exynos Scaler for DRM.

config DRM_EXYNOS_GSC
	bool "GScaler"
	depends on VIDEO_SAMSUNG_EXYNOS_GSC=n || COMPILE_TEST
	select DRM_EXYNOS_IPP
	help
	  Choose this option if you want to use Exynos GSC for DRM.

endif
```

## drivers/media/m2m1shot/Kconfig
```kconfig
# SPDX-License-Identifier: GPL-2.0-only

config MEDIA_M2M1SHOT
	bool "The non-streaming m2m media processing (m2m1shot) API"
	help
	  Enables support for the non-streaming m2m media processing API
	  for the Exynos MSCL scaler driver (spec L6B 5.9; stock
	  CONFIG_MEDIA_M2M1SHOT=y).
```

## drivers/media/m2m1shot2/Kconfig
```kconfig
# SPDX-License-Identifier: GPL-2.0-only

config MEDIA_M2M1SHOT2
	bool "The extended non-streaming m2m media processing (m2m1shot2) API"
	help
	  Enables support for the extended non-streaming m2m media processing API
	  for some device drivers like FIMG2D.
```

## drivers/media/platform/samsung/Kconfig
```kconfig
# SPDX-License-Identifier: GPL-2.0-only

comment "Samsung media platform drivers"

source "drivers/media/platform/samsung/exynos-gsc/Kconfig"
source "drivers/media/platform/samsung/exynos4-is/Kconfig"
source "drivers/media/platform/samsung/s3c-camif/Kconfig"
source "drivers/media/platform/samsung/s5p-g2d/Kconfig"
source "drivers/media/platform/samsung/s5p-jpeg/Kconfig"
source "drivers/media/platform/samsung/s5p-mfc/Kconfig"

# WP-6L
source "drivers/media/platform/samsung/g2d1shot/Kconfig"

# WP-l6m
source "drivers/media/platform/samsung/smfc-exynos/Kconfig"
source "drivers/media/platform/samsung/scaler-exynos/Kconfig"
```

## drivers/media/platform/samsung/g2d1shot/Kconfig
```kconfig
# SPDX-License-Identifier: GPL-2.0-only
#
# Copyright (c) 2015 Samsung Electronics Co., Ltd.
#		http://www.samsung.com/
#

config VIDEO_EXYNOS_G2D1SHOT
	bool "G2D m2m1shot2 version"
	depends on EXYNOS_IOMMU && SYNC_FILE && DMA_SHARED_BUFFER && OF
	select MEDIA_M2M1SHOT2
	help
	  This is a driver for the Samsung Exynos 2D blitter hardware (FIMG2D)
	  using the m2m1shot2 framework.
```

## drivers/media/platform/samsung/mfc-exynos8895/Kconfig
```kconfig
# SPDX-License-Identifier: GPL-2.0-only
config VIDEO_EXYNOS8895_MFC
	bool "Samsung Exynos8895 MFC v11 video codec (stock transplant)"
	depends on VIDEO_DEV && ARCH_EXYNOS && EXYNOS_IOMMU
	select VIDEOBUF2_DMA_CONTIG
	select V4L2_MEM2MEM_DEV
	help
	  MFC v11 decoder/encoder of the Exynos8895 (Galaxy Note 8), the
	  stock SM-N950N driver ported to this kernel. It keeps the stock
	  V4L2 nodes (/dev/video6..9), names and Exynos private controls
	  that the LineageOS OMX components use. Firmware: mfc_fw.bin.
```

## drivers/media/platform/samsung/scaler-exynos/Kconfig
```kconfig
# SPDX-License-Identifier: GPL-2.0-only

config VIDEO_EXYNOS_SCALER
	bool "Samsung Exynos MSCL (M2M scaler) driver"
	depends on VIDEO_DEV
	depends on ARCH_EXYNOS || COMPILE_TEST
	select VIDEOBUF2_DMA_CONTIG
	select V4L2_MEM2MEM_DEV
	select SYNC_FILE
	select MEDIA_M2M1SHOT
	help
	  This is a v4l2 driver for the Samsung Exynos MSCL M2M scaler,
	  with USE_SYNC acquire/release fences (spec L6B 5.9, L6A
	  REQ-L6B-6A-1; stock CONFIG_VIDEO_EXYNOS_SCALER=y).
```

## drivers/media/platform/samsung/smfc-exynos/Kconfig
```kconfig
# SPDX-License-Identifier: GPL-2.0-only

config VIDEO_EXYNOS_SMFC
	bool "Samsung Exynos SMFC (Still MFC / H/W JPEG codec) driver"
	depends on VIDEO_DEV
	depends on ARCH_EXYNOS || COMPILE_TEST
	select VIDEOBUF2_DMA_CONTIG
	select V4L2_MEM2MEM_DEV
	help
	  This is a v4l2 driver for the Samsung Exynos SMFC H/W JPEG
	  codec (spec L6B 5.9; stock CONFIG_VIDEO_EXYNOS_SMFC=y).
```

## drivers/optics/Kconfig
```kconfig
#
# optics drivers configuration
#
# L6C 5.10: the stock entries S:drivers/optics/Kconfig:5-20, :60-76 of the MAX8690x HRM
# family driver this board builds (IKC:4825-4832), built in (bool).
#

config SENSORS_HRMSENSOR
	bool "HRM Sensor Driver Common"
	default n
	depends on I2C && GPIOLIB && OF
	depends on SENSORS_SYSFS
	help
	  If you say yes here you get support for the HRM sensor.

config SENSORS_HRM_MAX86902
	bool "HRM Sensor Driver MAX86902"
	default n
	depends on SENSORS_HRMSENSOR
	help
	  If you say yes here you get support for the HRM sensor.
	  This driver should be set with SENSORS_HRMSENSOR.
	  It serves the MAX86900/86902/86907/86909 family.

config SENSORS_HRM_MAX869_ENHANCED_EOL
	bool "MAX869 HRM sensor enhanced eol"
	depends on SENSORS_HRM_MAX86902
	default n
	help
	  If you want to apply enhanced eol process, it should be set.

config SENSORS_HRM_MAX869_NEW_EOL
	bool "MAX869 HRM sensor new eol"
	depends on SENSORS_HRM_MAX86902
	default n
	help
	  If you want to apply new eol process, it should be set.

config MAX86902_THRESHOLD
	int "MAX86902 HRM sensor finger detection threshold"
	depends on SENSORS_HRM_MAX86902
	default 70000
	help
	  If you want to change finger detection threshold, it should be set.
```

## drivers/soc/samsung/Kconfig
```kconfig
# SPDX-License-Identifier: GPL-2.0
#
# Samsung SoC drivers
#
menuconfig SOC_SAMSUNG
	bool "Samsung SoC driver support" if COMPILE_TEST

if SOC_SAMSUNG

# There is no need to enable these drivers for ARMv8
config EXYNOS_ASV_ARM
	bool "Exynos ASV ARMv7-specific driver extensions" if COMPILE_TEST
	depends on EXYNOS_CHIPID

config EXYNOS_CHIPID
	tristate "Exynos ChipID controller and ASV driver"
	depends on ARCH_EXYNOS || COMPILE_TEST
	default ARCH_EXYNOS
	select EXYNOS_ASV_ARM if ARM && ARCH_EXYNOS
	select MFD_SYSCON
	select SOC_BUS
	help
	  Support for Samsung Exynos SoC ChipID and Adaptive Supply Voltage.
	  This driver can also be built as module (exynos_chipid).

config EXYNOS_CHIPID_LEGACY_SYSFS
	bool "Exynos chip-id revision in sysfs for vendor userspace"
	depends on EXYNOS_CHIPID
	help
	  Registers the "chip-id" system subsystem of the Samsung vendor
	  kernels with its "revision" attribute, the SoC main and sub
	  revision as eight hex digits. Proprietary Exynos display HAL
	  libraries read /sys/devices/system/chip-id/revision.

config EXYNOS_USI
	tristate "Exynos USI (Universal Serial Interface) driver"
	default ARCH_EXYNOS && ARM64
	depends on ARCH_EXYNOS || COMPILE_TEST
	select MFD_SYSCON
	help
	  Enable support for USI block. USI (Universal Serial Interface) is an
	  IP-core found in modern Samsung Exynos SoCs, like Exynos850 and
	  ExynosAutoV9. USI block can be configured to provide one of the
	  following serial protocols: UART, SPI or High Speed I2C.

	  This driver allows one to configure USI for desired protocol, which
	  is usually done in USI node in Device Tree.

config EXYNOS_PMU
	bool "Exynos PMU controller driver" if COMPILE_TEST
	depends on ARCH_EXYNOS || ((ARM || ARM64) && COMPILE_TEST)
	select EXYNOS_PMU_ARM_DRIVERS if ARM && ARCH_EXYNOS
	select MFD_CORE
	select REGMAP_MMIO

# There is no need to enable these drivers for ARMv8
config EXYNOS_PMU_ARM_DRIVERS
	bool "Exynos PMU ARMv7-specific driver extensions" if COMPILE_TEST
	depends on EXYNOS_PMU

config SAMSUNG_PM_CHECK
	bool "S3C2410 PM Suspend Memory CRC"
	depends on PM && (ARCH_S3C64XX || ARCH_S5PV210)
	select CRC32
	help
	  Enable the PM code's memory area checksum over sleep. This option
	  will generate CRCs of all blocks of memory, and store them before
	  going to sleep. The blocks are then checked on resume for any
	  errors.

	  Note, this can take several seconds depending on memory size
	  and CPU speed.

config SAMSUNG_PM_CHECK_CHUNKSIZE
	int "S3C2410 PM Suspend CRC Chunksize (KiB)"
	depends on PM && SAMSUNG_PM_CHECK
	default 64
	help
	  Set the chunksize in Kilobytes of the CRC for checking memory
	  corruption over suspend and resume. A smaller value will mean that
	  the CRC data block will take more memory, but will identify any
	  faults with better precision.

config EXYNOS_REGULATOR_COUPLER
	bool "Exynos SoC Regulator Coupler" if COMPILE_TEST
	depends on ARCH_EXYNOS || COMPILE_TEST

config EXYNOS8895_SMC
	bool
	help
	  exynos8895_smc(): plain secure monitor calls to the Samsung EL3
	  monitor of the Exynos8895, for the vendor calls that are not SMCCC
	  services (secure RPMB, secure log, modem power control, ABOX).
	  Selected by its users.

config EXYNOS8895_PM
	bool "Exynos8895 system suspend, SICD and PM-DVS support"
	depends on ARCH_EXYNOS && ARM64 && EXYNOS_PMU && SUSPEND && ARM_PSCI_FW
	select EXYNOS8895_SMC
	help
	  System suspend to the Exynos8895 SLEEP state with the vendor PMU
	  sequences, the SICD entry, exit and veto used by the Exynos8895
	  cpuidle driver, the suspend voltages of the BUCK8-11 rails, the
	  PMU CPU and cluster power hooks for deep idle and CPU hotplug, and
	  the EL3 monitor debug page and exception handler.

config EXYNOS8895_MCINFO
	bool "Exynos8895 DRAM MR4 temperature trip"
	depends on ARCH_EXYNOS && OF
	help
	  Reports the DRAM temperature range that the four Exynos8895
	  memory controller channels read from the MR4 mode register, in
	  sysfs (ref_rate/ref_rate), and panics on a memory controller
	  over-temperature interrupt, as the vendor exynos-mcinfo driver.
config SAMSUNG_SEC_CLASS
	bool "Samsung \"sec\" device class"
	depends on ARCH_EXYNOS
	help
	  The /sys/class/sec device class of the Samsung vendor kernels,
	  whose device nodes (tsp, led, ...) the Samsung device HALs use.
	  Provides sec_device_create_with_groups() and sec_device_destroy()
	  for the drivers that create those nodes.

config EXYNOS_UFS_SRPMB
	bool "Exynos secure RPMB proxy for the Trustonic TEE"
	depends on SCSI_UFSHCD && ARCH_EXYNOS
	select EXYNOS8895_SMC
	help
	  Forwards the RPMB requests of the Exynos8895 secure world, which
	  the Trustonic TEE uses for its secure storage, to the RPMB
	  well-known logical unit of the UFS device. The vendor kernels
	  call this CONFIG_UFS_SRPMB.
endif
```
