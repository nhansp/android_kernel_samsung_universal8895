## Documentation/devicetree/bindings/soc/samsung/samsung,exynos8895-mcinfo.yaml
```yaml
# SPDX-License-Identifier: (GPL-2.0-only OR BSD-2-Clause)
%YAML 1.2
---
$id: http://devicetree.org/schemas/soc/samsung/samsung,exynos8895-mcinfo.yaml#
$schema: http://devicetree.org/meta-schemas/core.yaml#

title: Samsung Exynos8895 DRAM temperature trip (mcinfo)

maintainers:
  - nhansp <nhan.094.vn@gmail.com>

description: |
  One status word in each of the four Exynos8895 memory controller channels
  (DMC0..3) that carries the DRAM temperature range read from MR4, and the
  four DMC over-temperature interrupts. The driver reports the fields on
  demand and panics on any of the interrupts. The position of the field is
  data of the compatible.

properties:
  compatible:
    const: samsung,exynos8895-mcinfo

  reg:
    minItems: 4
    maxItems: 4
    description: the status word of DMC channel 0, 1, 2 and 3

  interrupts:
    minItems: 4
    maxItems: 4
    description: the over-temperature interrupt of DMC channel 0, 1, 2 and 3

required:
  - compatible
  - reg
  - interrupts

additionalProperties: false

examples:
  - |
    #include <dt-bindings/interrupt-controller/arm-gic.h>

    mcinfo@1603004c {
        compatible = "samsung,exynos8895-mcinfo";
        reg = <0x1603004c 0x4>, <0x1613004c 0x4>,
              <0x1623004c 0x4>, <0x1633004c 0x4>;
        interrupts = <GIC_SPI 115 IRQ_TYPE_LEVEL_HIGH>,
                     <GIC_SPI 122 IRQ_TYPE_LEVEL_HIGH>,
                     <GIC_SPI 129 IRQ_TYPE_LEVEL_HIGH>,
                     <GIC_SPI 136 IRQ_TYPE_LEVEL_HIGH>;
    };
```

## Documentation/devicetree/bindings/thermal/samsung,exynos-thermal.yaml
```yaml
# SPDX-License-Identifier: (GPL-2.0-only OR BSD-2-Clause)
%YAML 1.2
---
$id: http://devicetree.org/schemas/thermal/samsung,exynos-thermal.yaml#
$schema: http://devicetree.org/meta-schemas/core.yaml#

title: Samsung Exynos SoC Thermal Management Unit (TMU)

maintainers:
  - Krzysztof Kozlowski <krzk@kernel.org>

description: |
  For multi-instance tmu each instance should have an alias correctly numbered
  in "aliases" node.

properties:
  compatible:
    enum:
      - samsung,exynos3250-tmu
      - samsung,exynos4412-tmu
      - samsung,exynos4210-tmu
      - samsung,exynos5250-tmu
      - samsung,exynos5260-tmu
        # For TMU channel 0, 1 on Exynos5420:
      - samsung,exynos5420-tmu
        # For TMU channels 2, 3 and 4 of Exynos5420:
      - samsung,exynos5420-tmu-ext-triminfo
      - samsung,exynos5433-tmu
      - samsung,exynos7-tmu
      - samsung,exynos8895-tmu

  clocks:
    minItems: 1
    maxItems: 3

  clock-names:
    minItems: 1
    maxItems: 3

  interrupts:
    description: |
      The Exynos TMU supports generating interrupts when reaching given
      temperature thresholds. Number of supported thermal trip points depends
      on the SoC (only first trip points defined in DT will be configured)::
       - most of SoC: 4
       - samsung,exynos5433-tmu: 8
       - samsung,exynos7-tmu: 8
       - samsung,exynos8895-tmu: 8
    maxItems: 1

  reg:
    items:
      - description: TMU instance registers.
      - description: |
          Shared TMU registers.

          Note:: On Exynos5420, the TRIMINFO register is misplaced for TMU
          channels 2, 3 and 4 Use "samsung,exynos5420-tmu-ext-triminfo" in
          cases, there is a misplaced register, also provide clock to access
          that base.
          TRIMINFO at 0x1006c000 contains data for TMU channel 3
          TRIMINFO at 0x100a0000 contains data for TMU channel 4
          TRIMINFO at 0x10068000 contains data for TMU channel 2
    minItems: 1

  '#thermal-sensor-cells':
    const: 0

  samsung,tmu-sensors:
    $ref: /schemas/types.yaml#/definitions/uint32
    minimum: 1
    maximum: 0xff
    description:
      Bit mask of the remote temperature sensors of the TMU block that belong
      to this instance (Exynos8895 has up to eight per block, and two
      instances can share a block with different sensors).

  samsung,tmu-sensing-mode:
    $ref: /schemas/types.yaml#/definitions/string
    enum: [max, balance]
    description:
      How the sensors of the mask give one temperature. "max" is the highest
      reading; "balance" also takes the highest, after subtracting 20 degrees
      Celsius from every sensor but sensor 0.

  vtmu-supply:
    description: The regulator node supplying voltage to TMU.

  samsung,ipa-k-po:
    $ref: /schemas/types.yaml#/definitions/uint32
    description:
      Proportional gain of the power allocator governor above the control
      temperature, in mW per degree Celsius, for the thermal zone of this
      instance. With the other four samsung,ipa-* properties it makes the
      driver run that zone on the power_allocator governor, once every
      cooling device bound to the zone is a power actor.

  samsung,ipa-k-pu:
    $ref: /schemas/types.yaml#/definitions/uint32
    description:
      Proportional gain of the power allocator below the control
      temperature, in mW per degree Celsius.

  samsung,ipa-k-i:
    $ref: /schemas/types.yaml#/definitions/uint32
    description:
      Integral gain of the power allocator, in mW per degree Celsius and
      polling period.

  samsung,ipa-integral-max:
    $ref: /schemas/types.yaml#/definitions/uint32
    description:
      Upper limit of the power allocator's integral term, in mW.

  samsung,ipa-integral-cutoff:
    $ref: /schemas/types.yaml#/definitions/uint32
    description:
      The error (control temperature minus temperature) is integrated only
      while it is below this value, in degrees Celsius.

  samsung,hotplug-cpus:
    $ref: /schemas/types.yaml#/definitions/phandle-array
    items:
      maxItems: 1
    description:
      CPUs taken offline while the temperature of this instance is at or
      above samsung,hotplug-out-temp, until it falls below
      samsung,hotplug-in-temp.

  samsung,hotplug-out-temp:
    $ref: /schemas/types.yaml#/definitions/uint32
    description: Temperature in millicelsius that takes samsung,hotplug-cpus offline.

  samsung,hotplug-in-temp:
    $ref: /schemas/types.yaml#/definitions/uint32
    description: Temperature in millicelsius below which samsung,hotplug-cpus come back.

  samsung,boot-qos-cpus:
    $ref: /schemas/types.yaml#/definitions/phandle-array
    minItems: 1
    maxItems: 2
    items:
      maxItems: 1
    description:
      One CPU of each cluster whose cpufreq policy is held at its boot level,
      as both minimum and maximum, for samsung,boot-qos-ms after the policy
      is created. The boot level is the highest frequency of the policy
      unless samsung,boot-max-freq lowers it.

  samsung,boot-qos-ms:
    description: How long the boot level is held, in milliseconds.

  samsung,boot-max-freq:
    $ref: /schemas/types.yaml#/definitions/uint32-matrix
    description:
      Rows of a temperature in millicelsius followed by one frequency in kHz
      per samsung,boot-qos-cpus entry. The first row whose temperature the
      instance's sensor 0 exceeds, read when the policy is created, caps the
      boot level; 0 stands for the lowest frequency of the policy.

dependencies:
  samsung,ipa-k-po: [ samsung,ipa-k-pu, samsung,ipa-k-i, samsung,ipa-integral-max, samsung,ipa-integral-cutoff ]
  samsung,ipa-k-pu: [ samsung,ipa-k-po ]
  samsung,ipa-k-i: [ samsung,ipa-k-po ]
  samsung,ipa-integral-max: [ samsung,ipa-k-po ]
  samsung,ipa-integral-cutoff: [ samsung,ipa-k-po ]
  samsung,hotplug-cpus: [ samsung,hotplug-out-temp, samsung,hotplug-in-temp ]
  samsung,hotplug-out-temp: [ samsung,hotplug-cpus ]
  samsung,hotplug-in-temp: [ samsung,hotplug-cpus ]
  samsung,boot-qos-cpus: [ samsung,boot-qos-ms, samsung,boot-max-freq ]
  samsung,boot-qos-ms: [ samsung,boot-qos-cpus ]
  samsung,boot-max-freq: [ samsung,boot-qos-cpus ]

required:
  - compatible
  - clocks
  - clock-names
  - interrupts
  - reg

allOf:
  - $ref: /schemas/thermal/thermal-sensor.yaml
  - if:
      properties:
        compatible:
          contains:
            const: samsung,exynos5420-tmu-ext-triminfo
    then:
      properties:
        clocks:
          items:
            - description:
                Operational clock for TMU channel.
            - description:
                Optional clock to access the shared registers (e.g. TRIMINFO) of TMU
                channel.
        clock-names:
          items:
            - const: tmu_apbif
            - const: tmu_triminfo_apbif
        reg:
          minItems: 2
          maxItems: 2
  - if:
      properties:
        compatible:
          contains:
            enum:
              - samsung,exynos5433-tmu
              - samsung,exynos7-tmu
    then:
      properties:
        clocks:
          items:
            - description:
                Operational clock for TMU channel.
            - description:
                Optional special clock for functional operation of TMU channel.
        clock-names:
          items:
            - const: tmu_apbif
            - const: tmu_sclk
        reg:
          minItems: 1
          maxItems: 1

  - if:
      properties:
        compatible:
          contains:
            const: samsung,exynos8895-tmu
    then:
      properties:
        clocks:
          maxItems: 1
        clock-names:
          items:
            - const: tmu_apbif
        reg:
          maxItems: 1
      required:
        - samsung,tmu-sensors
        - samsung,tmu-sensing-mode
    else:
      properties:
        samsung,tmu-sensors: false
        samsung,tmu-sensing-mode: false
        samsung,ipa-k-po: false
        samsung,ipa-k-pu: false
        samsung,ipa-k-i: false
        samsung,ipa-integral-max: false
        samsung,ipa-integral-cutoff: false
        samsung,hotplug-cpus: false
        samsung,hotplug-out-temp: false
        samsung,hotplug-in-temp: false
        samsung,boot-qos-cpus: false
        samsung,boot-qos-ms: false
        samsung,boot-max-freq: false

  - if:
      properties:
        compatible:
          contains:
            enum:
              - samsung,exynos3250-tmu
              - samsung,exynos4412-tmu
              - samsung,exynos4210-tmu
              - samsung,exynos5250-tmu
              - samsung,exynos5260-tmu
              - samsung,exynos5420-tmu
    then:
      properties:
        clocks:
          minItems: 1
          maxItems: 1
        reg:
          minItems: 1
          maxItems: 1

additionalProperties: false

examples:
  - |
    #include <dt-bindings/clock/exynos4.h>

    tmu@100c0000 {
        compatible = "samsung,exynos4412-tmu";
        reg = <0x100C0000 0x100>;
        interrupt-parent = <&combiner>;
        interrupts = <2 4>;
        #thermal-sensor-cells = <0>;
        clocks = <&clock CLK_TMU_APBIF>;
        clock-names = "tmu_apbif";
        vtmu-supply = <&ldo10_reg>;
    };

  - |
    #include <dt-bindings/interrupt-controller/arm-gic.h>

    tmu@10068000 {
        compatible = "samsung,exynos5420-tmu-ext-triminfo";
        reg = <0x10068000 0x100>, <0x1006c000 0x4>;
        interrupts = <GIC_SPI 184 IRQ_TYPE_LEVEL_HIGH>;
        #thermal-sensor-cells = <0>;
        clocks = <&clock 318>, <&clock 318>; /* CLK_TMU */
        clock-names = "tmu_apbif", "tmu_triminfo_apbif";
        vtmu-supply = <&ldo7_reg>;
    };

  - |
    #include <dt-bindings/interrupt-controller/arm-gic.h>

    tmu@10060000 {
        compatible = "samsung,exynos5433-tmu";
        reg = <0x10060000 0x200>;
        interrupts = <GIC_SPI 95 IRQ_TYPE_LEVEL_HIGH>;
        #thermal-sensor-cells = <0>;
        clocks = <&cmu_peris 3>, /* CLK_PCLK_TMU0_APBIF */
                 <&cmu_peris 35>; /* CLK_SCLK_TMU0 */
        clock-names = "tmu_apbif", "tmu_sclk";
        vtmu-supply = <&ldo3_reg>;
    };
```

## Documentation/devicetree/bindings/usb/maxim,max77865-muic.yaml
```yaml
# SPDX-License-Identifier: (GPL-2.0-only OR BSD-2-Clause)
%YAML 1.2
---
$id: http://devicetree.org/schemas/usb/maxim,max77865-muic.yaml#
$schema: http://devicetree.org/meta-schemas/core.yaml#

title: Maxim MAX77865 MUIC (USB D+/D- switch and BC1.2 detection)

maintainers:
  - nhansp <nhan.094.vn@gmail.com>

description:
  The micro-USB interface controller block of the Maxim MAX77865 PMIC, a
  separate I2C client of the PMIC package. It routes the connector's D+/D-
  lines to the application processor's USB PHY or UART, runs the BC1.2
  charger detection and carries the AFC/QC high-voltage signalling. On the
  Samsung Galaxy Note 8 it works under the S2MM005 USB Type-C port
  controller, which references it with samsung,muic.

properties:
  compatible:
    const: maxim,max77865-muic

  reg:
    maxItems: 1

  interrupts:
    maxItems: 1
    description: MUIC interrupt line, level low

  wakeup-source: true

required:
  - compatible
  - reg
  - interrupts

additionalProperties: false

examples:
  - |
    #include <dt-bindings/interrupt-controller/irq.h>

    i2c {
        #address-cells = <1>;
        #size-cells = <0>;

        muic@25 {
            compatible = "maxim,max77865-muic";
            reg = <0x25>;
            interrupts-extended = <&gpa0 0 IRQ_TYPE_LEVEL_LOW>;
            wakeup-source;
        };
    };
```

## Documentation/devicetree/bindings/usb/samsung,s2mm005.yaml
```yaml
# SPDX-License-Identifier: (GPL-2.0-only OR BSD-2-Clause)
%YAML 1.2
---
$id: http://devicetree.org/schemas/usb/samsung,s2mm005.yaml#
$schema: http://devicetree.org/meta-schemas/core.yaml#

title: Samsung S2MM005 USB Type-C / Power Delivery port controller

maintainers:
  - nhansp <nhan.094.vn@gmail.com>

description:
  The S2MM005 runs USB Type-C and USB Power Delivery in its own firmware and
  reports the attach state, the data and power role and the PD messages over
  I2C. On the Samsung Galaxy Note 8 it works together with the MAX77865 MUIC,
  which switches the connector's D+/D- lines. The I2C controller node must
  provide a "hard_reset" pin state (SCL and SDA driven low) besides "default";
  it resets a controller that does not answer.

properties:
  compatible:
    const: samsung,s2mm005

  reg:
    maxItems: 1

  interrupts:
    maxItems: 1
    description: interrupt line of the controller, falling edge

  orientation-gpios:
    maxItems: 1
    description:
      the plug orientation output of the controller (USB3.1_COM_SEL); high
      means the plug is reversed

  samsung,muic:
    $ref: /schemas/types.yaml#/definitions/phandle
    description: the MAX77865 MUIC (maxim,max77865-muic) of the connector

  wakeup-source: true

  pinctrl-0: true

  pinctrl-names:
    const: default

  connector:
    type: object
    $ref: /schemas/connector/usb-connector.yaml#
    unevaluatedProperties: false

required:
  - compatible
  - reg
  - interrupts
  - samsung,muic
  - connector

additionalProperties: false

examples:
  - |
    #include <dt-bindings/gpio/gpio.h>
    #include <dt-bindings/interrupt-controller/irq.h>

    i2c {
        #address-cells = <1>;
        #size-cells = <0>;

        typec@33 {
            compatible = "samsung,s2mm005";
            reg = <0x33>;
            interrupts-extended = <&gpa1 7 IRQ_TYPE_EDGE_FALLING>;
            orientation-gpios = <&gpi1 7 GPIO_ACTIVE_HIGH>;
            samsung,muic = <&max77865_muic>;
            wakeup-source;

            connector {
                compatible = "usb-c-connector";
                label = "USB-C";
                power-role = "dual";
                data-role = "dual";
                try-power-role = "sink";
                typec-power-opmode = "default";
            };
        };
    };
```
