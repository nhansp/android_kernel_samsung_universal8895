## Documentation/devicetree/bindings/input/semtech,sx9320-grip.txt
```
Semtech SX9320 capacitive grip sensor (Samsung input driver)
============================================================

The SX9320 of the Galaxy Note 8 reports grip touch/release as the input device
grip_sensor (REL_MISC 1 = touch, 2 = release) with Samsung sysfs nodes
(drivers/sensorhub/brcm/sx9320.c); it is not the IIO sx9310/sx9324/sx9360
binding. The transplanted parser reads the stock sx9320,* names.

Required properties:
- compatible: "semtech,sx9320-grip"
- reg: I2C address (0x28)
- sx9320,nirq-gpio: the nIRQ line; the driver derives the interrupt from it
  and requests it falling-edge
- sx9320,phen, sx9320,gain, sx9320,again, sx9320,scan_period, sx9320,range,
  sx9320,sampling_freq, sx9320,resolution, sx9320,rawfilt, sx9320,hyst,
  sx9320,avgposfilt, sx9320,avgnegfilt, sx9320,avgthresh, sx9320,debouncer,
  sx9320,normal_thd, sx9320,afeph0, sx9320,afeph1, sx9320,afeph2,
  sx9320,afeph3: register values (u32 cells holding u8 values)

Optional properties:
- pinctrl-names, pinctrl-0: "default" state of the nIRQ pin

Example: arch/arm64/boot/dts/exynos/exynos8895-greatlte-l6c.dtsi (grip@28).
```

## Documentation/devicetree/bindings/input/touchscreen/wacom,w9018.yaml
```yaml
# SPDX-License-Identifier: (GPL-2.0-only OR BSD-2-Clause)
%YAML 1.2
---
$id: http://devicetree.org/schemas/input/touchscreen/wacom,w9018.yaml#
$schema: http://devicetree.org/meta-schemas/core.yaml#

title: Wacom W9018 digitizer

maintainers:
  - nhansp <nhan.094.vn@gmail.com>

description:
  I2C pen digitizer of the Samsung Galaxy Note 8 S Pen, with a pen detect
  (PDCT) line that reports whether the pen is in its slot.

properties:
  compatible:
    const: wacom,w9018

  reg:
    maxItems: 1

  interrupts:
    maxItems: 2

  interrupt-names:
    items:
      - const: data
      - const: pdct

  pdct-gpios:
    maxItems: 1
    description: GPIO connected to pen detection (PDCT) pin

  fwe-gpios:
    maxItems: 1
    description: GPIO connected to flash write enable (FWE) pin

  vddo-supply:
    description: Power supply regulator for digitizer

  wacom,xy-switch:
    type: boolean
    description: Swap X and Y coordinates

  wacom,x-invert:
    type: boolean
    description: Invert X coordinate

  pinctrl-0: true
  pinctrl-names: true

required:
  - compatible
  - reg
  - interrupts
  - interrupt-names
  - pdct-gpios
  - fwe-gpios
  - vddo-supply

additionalProperties: false

examples:
  - |
    #include <dt-bindings/interrupt-controller/irq.h>
    #include <dt-bindings/gpio/gpio.h>
    i2c {
        #address-cells = <1>;
        #size-cells = <0>;

        digitizer@56 {
            compatible = "wacom,w9018";
            reg = <0x56>;
            interrupt-parent = <&gpa2>;
            interrupts = <2 IRQ_TYPE_LEVEL_LOW>,
                         <1 IRQ_TYPE_EDGE_BOTH>;
            interrupt-names = "data", "pdct";
            pdct-gpios = <&gpa2 1 GPIO_ACTIVE_HIGH>;
            fwe-gpios = <&gpe7 4 GPIO_ACTIVE_HIGH>;
            vddo-supply = <&wacom_3v3>;
            wacom,xy-switch;
            wacom,x-invert;
            pinctrl-names = "default";
            pinctrl-0 = <&epen_int_active>;
        };
    };
```

## Documentation/devicetree/bindings/media/samsung,exynos8895-g2d.yaml
```yaml
# SPDX-License-Identifier: (GPL-2.0-only OR BSD-2-Clause)
%YAML 1.2
---
$id: http://devicetree.org/schemas/media/samsung,exynos8895-g2d.yaml#
$schema: http://devicetree.org/meta-schemas/core.yaml#

title: Samsung Exynos8895 2D Graphic Accelerator (G2D)

maintainers:
  - nhansp <nhan.094.vn@gmail.com>

description:
  Exynos 8895 2D graphic accelerator (FIMG2D) blitter, driven through the
  m2m1shot2 framework.

properties:
  compatible:
    const: samsung,exynos8895-g2d

  reg:
    maxItems: 1

  interrupts:
    maxItems: 1

  clocks:
    maxItems: 1

  clock-names:
    items:
      - const: gate

  power-domains:
    maxItems: 1

  iommus:
    minItems: 2
    maxItems: 2

  samsung,hw-ppc:
    $ref: /schemas/types.yaml#/definitions/uint32-array
    minItems: 3
    maxItems: 3
    description:
      Pixels-per-cycle performance values for default, rotation, and color-fill.

  samsung,skia-qos-table:
    $ref: /schemas/types.yaml#/definitions/uint32-matrix
    items:
      items:
        - description: cluster 0 minimum frequency in kHz
        - description: cluster 1 minimum frequency in kHz
        - description: MIF minimum frequency in kHz
    description:
      Skia QoS levels, one {cluster0, cluster1, mif} row per level.

required:
  - compatible
  - reg
  - interrupts
  - clocks
  - clock-names
  - power-domains
  - iommus

additionalProperties: false

examples:
  - |
    #include <dt-bindings/clock/samsung,exynos8895.h>
    #include <dt-bindings/interrupt-controller/arm-gic.h>

    g2d@13a30000 {
        compatible = "samsung,exynos8895-g2d";
        reg = <0x13a30000 0x1000>;
        interrupts = <GIC_SPI 224 IRQ_TYPE_LEVEL_HIGH>;
        clocks = <&cmu_g2d CLK_GOUT_G2D_CLK>;
        clock-names = "gate";
        power-domains = <&pd_g2d>;
        iommus = <&sysmmu_g2dd0>, <&sysmmu_g2dd1>;
        samsung,hw-ppc = <2800 2400 3800>;
        samsung,skia-qos-table = <0 0 1014000>, <0 0 1014000>, <0 0 845000>,
                                 <0 0 845000>, <0 0 676000>, <0 0 0>;
    };
```

## Documentation/devicetree/bindings/media/samsung,exynos8895-jpeg.yaml
```yaml
# SPDX-License-Identifier: (GPL-2.0-only OR BSD-2-Clause)
%YAML 1.2
---
$id: http://devicetree.org/schemas/media/samsung,exynos8895-jpeg.yaml#
$schema: http://devicetree.org/meta-schemas/core.yaml#

title: Samsung Exynos8895 SMFC JPEG codec

maintainers:
  - nhansp <nhan.094.vn@gmail.com>

description:
  Exynos 8895 SMFC (Still MFC) H/W JPEG codec, /dev/video12
  (spec L6B 4.8, 5.9). The IOMMU master of sysmmu_g2dd2; the MSCL
  scaler maps through it as its proxy.

properties:
  compatible:
    const: samsung,exynos8895-jpeg

  reg:
    maxItems: 1

  interrupts:
    maxItems: 1

  clocks:
    maxItems: 1

  clock-names:
    items:
      - const: gate

  power-domains:
    maxItems: 1

  iommus:
    maxItems: 1

  dma-coherent: true

required:
  - compatible
  - reg
  - interrupts
  - clocks
  - clock-names
  - power-domains
  - iommus

additionalProperties: false

examples:
  - |
    #include <dt-bindings/clock/samsung,exynos8895.h>
    #include <dt-bindings/interrupt-controller/arm-gic.h>

    smfc: jpeg@13b00000 {
        compatible = "samsung,exynos8895-jpeg";
        dma-coherent;
        reg = <0x13b00000 0x1000>;
        interrupts = <GIC_SPI 225 IRQ_TYPE_LEVEL_HIGH>;
        clocks = <&cmu_g2d CLK_GOUT_G2D_JPEG_I_SMFC_CLK>;
        clock-names = "gate";
        iommus = <&sysmmu_g2dd2>;
        power-domains = <&pd_g2d>;
    };
```

## Documentation/devicetree/bindings/media/samsung,exynos8895-scaler.yaml
```yaml
# SPDX-License-Identifier: (GPL-2.0-only OR BSD-2-Clause)
%YAML 1.2
---
$id: http://devicetree.org/schemas/media/samsung,exynos8895-scaler.yaml#
$schema: http://devicetree.org/meta-schemas/core.yaml#

title: Samsung Exynos8895 MSCL M2M scaler

maintainers:
  - nhansp <nhan.094.vn@gmail.com>

description:
  Exynos 8895 MSCL M2M scaler, /dev/video50 plus the m2m1shot misc
  device m2m1shot_scaler0 (spec L6B 4.8, 5.9). Not an IOMMU master of
  its own: it maps through the SMFC proxy (one-master rule, 4.5).

properties:
  compatible:
    const: samsung,exynos8895-scaler

  reg:
    maxItems: 1

  interrupts:
    maxItems: 1

  clocks:
    maxItems: 1

  clock-names:
    items:
      - const: gate

  power-domains:
    maxItems: 1

  samsung,iommu-proxy:
    $ref: /schemas/types.yaml#/definitions/phandle
    description:
      The SMFC device owning sysmmu_g2dd2, which the scaler's DMA
      mappings and device link use.

  dma-coherent: true

required:
  - compatible
  - reg
  - interrupts
  - clocks
  - clock-names
  - power-domains
  - samsung,iommu-proxy

additionalProperties: false

examples:
  - |
    #include <dt-bindings/clock/samsung,exynos8895.h>
    #include <dt-bindings/interrupt-controller/arm-gic.h>

    scaler: scaler@13b10000 {
        compatible = "samsung,exynos8895-scaler";
        dma-coherent;
        reg = <0x13b10000 0x1300>;
        interrupts = <GIC_SPI 226 IRQ_TYPE_LEVEL_HIGH>;
        clocks = <&cmu_g2d CLK_GOUT_G2D_M2MSCALER_ACLK>;
        clock-names = "gate";
        samsung,iommu-proxy = <&smfc>;
        power-domains = <&pd_g2d>;
    };
```

## Documentation/devicetree/bindings/mfd/maxim,max77865.yaml
```yaml
# SPDX-License-Identifier: (GPL-2.0-only OR BSD-2-Clause)
%YAML 1.2
---
$id: http://devicetree.org/schemas/mfd/maxim,max77865.yaml#
$schema: http://devicetree.org/meta-schemas/core.yaml#

title: Maxim MAX77865 companion power management IC

maintainers:
  - Krzysztof Kozlowski <krzk@kernel.org>

description: |
  The MAX77865 is the companion PMIC of Exynos 8895 phones (Samsung Galaxy
  Note 8). This node is its top-level page at I2C address 0x66: the register
  map and the interrupt source register (INTSRC), whose bits are exposed as a
  one-cell interrupt controller: 0 charger, 1 top-level (system), 2 fuel gauge.
  The charger (0x69) and the fuel gauge (0x36) are separate nodes on the same
  bus (maxim,max77865-charger, maxim,max77865-battery).

properties:
  compatible:
    const: maxim,max77865

  reg:
    maxItems: 1

  interrupts:
    maxItems: 1

  interrupt-controller: true

  "#interrupt-cells":
    const: 1

  wakeup-source: true

  haptic:
    type: object
    additionalProperties: false
    description: Haptic motor driver for MAX77865.

    properties:
      compatible:
        const: maxim,max77865-haptic

      pwms:
        maxItems: 1

      maxim,max-duty-ns:
        $ref: /schemas/types.yaml#/definitions/uint32
        description: Maximum duty cycle in nanoseconds.

      maxim,max-timeout-ms:
        $ref: /schemas/types.yaml#/definitions/uint32
        description: Maximum vibration timeout in milliseconds.

      maxim,multi-freq-duty-ns:
        minItems: 7
        maxItems: 7
        description:
          Duty cycle of each of the seven vibration frequencies (alert, low,
          mid, high, 0, home key press, home key release). Entries 5 and 6
          drive the tick of the pressure home key.

      maxim,multi-freq-period-ns:
        minItems: 7
        maxItems: 7
        description:
          PWM period of each of the seven vibration frequencies, in the order
          of maxim,multi-freq-duty-ns.

    required:
      - compatible
      - pwms

  leds:
    type: object
    additionalProperties: false
    description: RGB LED controller for MAX77865.

    properties:
      compatible:
        const: maxim,max77865-rgb

      maxim,normal-current:
        $ref: /schemas/types.yaml#/definitions/uint32
        description: Current limit in normal power mode.

      maxim,lowpower-current:
        $ref: /schemas/types.yaml#/definitions/uint32
        description: Current limit in low power mode.

      maxim,brightness-ratio:
        $ref: /schemas/types.yaml#/definitions/uint32-array
        minItems: 3
        maxItems: 3
        description: Brightness ratios for R, G, B channels in normal power mode.

      maxim,brightness-ratio-low:
        $ref: /schemas/types.yaml#/definitions/uint32-array
        minItems: 3
        maxItems: 3
        description: Brightness ratios for R, G, B channels in low power mode.

    required:
      - compatible

required:
  - compatible
  - reg
  - interrupts
  - interrupt-controller
  - "#interrupt-cells"

additionalProperties: false

examples:
  - |
    #include <dt-bindings/interrupt-controller/irq.h>

    i2c {
        #address-cells = <1>;
        #size-cells = <0>;

        pmic@66 {
            compatible = "maxim,max77865";
            reg = <0x66>;
            interrupt-parent = <&gpa1>;
            interrupts = <6 IRQ_TYPE_LEVEL_LOW>;
            interrupt-controller;
            #interrupt-cells = <1>;
            wakeup-source;
        };
    };
```

## Documentation/devicetree/bindings/misc/samsung,exynos8895-gps-pwr.txt
```
Samsung GPS standby line (GPS_PWR_EN)
=====================================

The nSTDBY line of the BCM4774 GNSS/sensor-hub combo of the Galaxy Note 8,
exposed as /sys/class/sec/gps/GPS_PWR_EN/value for the Broadcom lhd daemon.

Required properties:
- compatible: "samsung,exynos8895-gps-pwr"
- gpios: the standby line (active high: 1 = GNSS out of standby)

Optional properties:
- pinctrl-names, pinctrl-0: "default" pin state of the line

Example:
	gps-pwr {
		compatible = "samsung,exynos8895-gps-pwr";
		pinctrl-names = "default";
		pinctrl-0 = <&ssp_gps_pwr_en>;
		gpios = <&gpf0 3 GPIO_ACTIVE_HIGH>;
	};
```

## Documentation/devicetree/bindings/misc/samsung,exynos8895-ion-legacy.yaml
```yaml
# SPDX-License-Identifier: (GPL-2.0-only OR BSD-2-Clause)
%YAML 1.2
---
$id: http://devicetree.org/schemas/misc/samsung,exynos8895-ion-legacy.yaml#
$schema: http://devicetree.org/meta-schemas/core.yaml#

title: Samsung Exynos 8895 legacy ION allocator

maintainers:
  - nhansp <nhan.094.vn@gmail.com>

description: |
  The /dev/ion allocator of the Samsung Exynos 4.4 kernels, kept for
  prebuilt userspace. Heap 0, the page allocator, is implicit. Every
  memory-region entry adds one heap: a reusable shared-dma-pool (CMA)
  region, or a reserved region marked "ion,secure" whose buffers are
  protected by the secure world. The node has no iommus and is not
  dma-coherent: the driver does CPU cache maintenance through it.

properties:
  compatible:
    const: samsung,exynos8895-ion-legacy

  memory-region:
    minItems: 1
    maxItems: 15
    description: one region per heap

  memory-region-names:
    minItems: 1
    maxItems: 15
    description: heap names; the driver appends "_heap"

  samsung,ion-heap-ids:
    $ref: /schemas/types.yaml#/definitions/uint32-array
    minItems: 1
    maxItems: 15
    items:
      minimum: 1
      maximum: 15
    description: legacy ION heap id of each memory-region entry (bit in heap_id_mask)

  samsung,ion-compat-ids:
    $ref: /schemas/types.yaml#/definitions/uint32-array
    minItems: 1
    maxItems: 15
    description:
      per memory-region entry, the bit mask of Exynos contig ids (18..31) that
      select this heap through heap_id_mask 0x10; 0 for none

required:
  - compatible

dependencies:
  memory-region: [ memory-region-names, samsung,ion-heap-ids, samsung,ion-compat-ids ]

additionalProperties: false

examples:
  - |
    ion {
        compatible = "samsung,exynos8895-ion-legacy";
        memory-region = <&camera_mem>, <&crypto_rmem>, <&vstream_rmem>;
        memory-region-names = "camera", "crypto", "vstream";
        samsung,ion-heap-ids = <10 1 3>;
        samsung,ion-compat-ids = <0 0 0x82000000>;
    };
```
