## Documentation/devicetree/bindings/pci/samsung,exynos8895-pcie.yaml
```yaml
# SPDX-License-Identifier: (GPL-2.0-only OR BSD-2-Clause)
%YAML 1.2
---
$id: http://devicetree.org/schemas/pci/samsung,exynos8895-pcie.yaml#
$schema: http://devicetree.org/meta-schemas/core.yaml#

title: Samsung Exynos8895 PCIe RC0 Host Controller

maintainers:
  - nhansp <nhan.094.vn@gmail.com>

description: |
  PCIe Root Complex 0 of the Samsung Exynos8895 SoC, based on the Synopsys
  DesignWare PCIe IP, with integrated PHY/PCS calibration and on-demand link
  power management for the BCM4361 Wi-Fi device. Local binding of the greatlte
  port (spec L6D 4), not for upstream.

allOf:
  - $ref: /schemas/pci/snps,dw-pcie.yaml#

properties:
  compatible:
    const: samsung,exynos8895-pcie

  reg:
    items:
      - description: Data Bus Interface (DBI) registers
      - description: External Local Bus Interface (ELBI) registers
      - description: PHY registers
      - description: PCS registers
      - description: Config space page

  reg-names:
    items:
      - const: dbi
      - const: elbi
      - const: phy
      - const: pcs
      - const: config

  interrupts:
    maxItems: 1

  clocks:
    items:
      - description: DBI clock
      - description: Master ACLK
      - description: Slave ACLK
      - description: Driver APB clock
      - description: Pipe APB clock
      - description: PHY APB clock
      - description: PHY reference clock
      - description: DBI clock of channel 1 (shared sub-controller)
      - description: Master ACLK of channel 1
      - description: Slave ACLK of channel 1
      - description: Driver APB clock of channel 1
      - description: TOE Wi-Fi 0 clock
      - description: TOE Wi-Fi 1 clock

  clock-names:
    items:
      - const: dbi
      - const: mstr
      - const: slv
      - const: apb
      - const: pipe_apb
      - const: phy_apb
      - const: ref
      - const: dbi1
      - const: mstr1
      - const: slv1
      - const: apb1
      - const: toe0
      - const: toe1

  samsung,pmu-syscon:
    $ref: /schemas/types.yaml#/definitions/phandle
    description: Phandle to the PMU system controller

  samsung,fsys-sysreg:
    $ref: /schemas/types.yaml#/definitions/phandle-array
    items:
      - items:
          - description: phandle to the FSYS1 sysreg syscon
          - description: offset of the PHY control register
    description: Phandle and offset to the FSYS1 syscon for PHY and bifurcation control

  num-lanes:
    const: 1

  reset-gpios:
    description: GPIO specification for PERST# reset line (active low)
    maxItems: 1

required:
  - compatible
  - reg
  - reg-names
  - interrupts
  - clocks
  - clock-names
  - samsung,pmu-syscon
  - samsung,fsys-sysreg
  - "#address-cells"
  - "#size-cells"
  - device_type
  - ranges
  - bus-range
  - "#interrupt-cells"
  - interrupt-map-mask
  - interrupt-map
  - num-lanes

unevaluatedProperties: false

examples:
  - |
    #include <dt-bindings/interrupt-controller/arm-gic.h>
    #include <dt-bindings/clock/samsung,exynos8895.h>

    soc {
        #address-cells = <1>;
        #size-cells = <1>;

        pcie0: pcie@11700000 {
            compatible = "samsung,exynos8895-pcie";
            reg = <0x11700000 0x1000>,
                  <0x116a0000 0x1000>,
                  <0x116d0000 0x1000>,
                  <0x116c0000 0x1fc>,
                  <0x11bff000 0x1000>;
            reg-names = "dbi", "elbi", "phy", "pcs", "config";
            interrupts = <GIC_SPI 345 IRQ_TYPE_LEVEL_HIGH>;
            clocks = <&cmu_fsys1 CLK_GOUT_FSYS1_PCIE_DBI_ACLK_0>,
                     <&cmu_fsys1 CLK_GOUT_FSYS1_PCIE_MSTR_ACLK_0>,
                     <&cmu_fsys1 CLK_GOUT_FSYS1_PCIE_SLV_ACLK_0>,
                     <&cmu_fsys1 CLK_GOUT_FSYS1_PCIE_PCIE_SUB_CTRL_INST_0_I_DRIVER_APB_CLK>,
                     <&cmu_fsys1 CLK_GOUT_FSYS1_PCIE_PIPE2_DIGITAL_X2_WRAP_INST_0_I_APB_PCLK_SCL>,
                     <&cmu_fsys1 CLK_GOUT_FSYS1_PCIE_IEEE1500_WRAPPER_FOR_PCIE_PHY_LC_X2_INST_0_I_SCL_APB_PCLK>,
                     <&cmu_fsys1 CLK_GOUT_FSYS1_PCIE_PHY_REF_CLK_IN>,
                     <&cmu_fsys1 CLK_GOUT_FSYS1_PCIE_DBI_ACLK_1>,
                     <&cmu_fsys1 CLK_GOUT_FSYS1_PCIE_MSTR_ACLK_1>,
                     <&cmu_fsys1 CLK_GOUT_FSYS1_PCIE_SLV_ACLK_1>,
                     <&cmu_fsys1 CLK_GOUT_FSYS1_PCIE_PCIE_SUB_CTRL_INST_1_I_DRIVER_APB_CLK>,
                     <&cmu_fsys1 CLK_GOUT_FSYS1_TOE_WIFI0_I_CLK>,
                     <&cmu_fsys1 CLK_GOUT_FSYS1_TOE_WIFI1_I_CLK>;
            clock-names = "dbi", "mstr", "slv", "apb", "pipe_apb", "phy_apb", "ref",
                          "dbi1", "mstr1", "slv1", "apb1", "toe0", "toe1";
            samsung,pmu-syscon = <&pmu_system_controller>;
            samsung,fsys-sysreg = <&syscon_fsys1 0x1044>;
            #address-cells = <3>;
            #size-cells = <2>;
            device_type = "pci";
            ranges = <0x82000000 0x0 0x11800000 0x11800000 0x0 0x400000>;
            bus-range = <0x00 0xff>;
            #interrupt-cells = <1>;
            interrupt-map-mask = <0 0 0 0>;
            interrupt-map = <0 0 0 0 &gic GIC_SPI 345 IRQ_TYPE_LEVEL_HIGH>;
            num-lanes = <1>;
            status = "disabled";
        };
    };
```

## Documentation/devicetree/bindings/power/pd-samsung.yaml
```yaml
# SPDX-License-Identifier: GPL-2.0
%YAML 1.2
---
$id: http://devicetree.org/schemas/power/pd-samsung.yaml#
$schema: http://devicetree.org/meta-schemas/core.yaml#

title: Samsung Exynos SoC Power Domains

maintainers:
  - Krzysztof Kozlowski <krzk@kernel.org>

description: |+
  Exynos processors include support for multiple power domains which are used
  to gate power to one or more peripherals on the processor.

allOf:
  - $ref: power-domain.yaml#
  - if:
      properties:
        compatible:
          contains:
            const: samsung,exynos8895-pd
    then:
      properties:
        reg:
          minItems: 1
          items:
            - description: CONFIGURATION, STATUS and OPTION registers of the
                domain in the PMU
            - description: register window of the block whose registers the
                domain's power sequence writes (the CMU_G3D PLL and mux words
                for the Exynos8895 G3D domain)
    else:
      properties:
        reg:
          maxItems: 1
        samsung,pmu-syscon: false
        samsung,sysreg: false

properties:
  compatible:
    oneOf:
      - enum:
          - samsung,exynos4210-pd
          - samsung,exynos5433-pd
      - items:
          - const: samsung,exynos8895-pd
          - const: samsung,exynos5433-pd

  reg:
    minItems: 1
    maxItems: 2

  clocks:
    deprecated: true
    maxItems: 1

  clock-names:
    deprecated: true
    maxItems: 1

  label:
    description:
      Human readable string with domain name. Will be visible in userspace
      to let user to distinguish between multiple domains in SoC.

  "#power-domain-cells":
    const: 0

  power-domains:
    maxItems: 1

  samsung,pmu-syscon:
    $ref: /schemas/types.yaml#/definitions/phandle
    description:
      PMU system controller, for the PMU bits the domain's power-off sequence
      sets before the domain is switched off (Exynos8895 ABOX domain).

  samsung,sysreg:
    $ref: /schemas/types.yaml#/definitions/phandle
    description:
      System register block of the domain. Its words that the domain loses
      when it is switched off are saved before power-off and restored after
      power-on.

required:
  - compatible
  - "#power-domain-cells"
  - reg

unevaluatedProperties: false

examples:
  - |
    lcd0_pd: power-domain@10023c80 {
        compatible = "samsung,exynos4210-pd";
        reg = <0x10023c80 0x20>;
        #power-domain-cells = <0>;
        label = "LCD0";
    };

    mfc_pd: power-domain@10044060 {
        compatible = "samsung,exynos4210-pd";
        reg = <0x10044060 0x20>;
        #power-domain-cells = <0>;
        label = "MFC";
    };

  - |
    pd_g3d: power-domain@164840e0 {
        compatible = "samsung,exynos8895-pd", "samsung,exynos5433-pd";
        reg = <0x164840e0 0x20>, <0x13800000 0x1000>;
        #power-domain-cells = <0>;
        label = "g3d";
    };
```

## Documentation/devicetree/bindings/power/samsung,exynos8895-pm.yaml
```yaml
# SPDX-License-Identifier: (GPL-2.0-only OR BSD-2-Clause)
%YAML 1.2
---
$id: http://devicetree.org/schemas/power/samsung,exynos8895-pm.yaml#
$schema: http://devicetree.org/meta-schemas/core.yaml#

title: Samsung Exynos8895 system power management

maintainers:
  - nhansp <nhan.094.vn@gmail.com>

description: |
  System suspend to the SLEEP state (and its VTS and audio variants), the
  system idle clock-down (SICD) veto and the suspend voltages of the BUCK8-11
  rails (PM-DVS) of the Samsung Exynos8895 SoC. The registers are PMU
  registers and the power-down sequences are built into the driver; the node
  is a child of the Exynos PMU system controller.

properties:
  compatible:
    const: samsung,exynos8895-pm

  vdd-mldo-supply:
    description: BUCK11 "vdd_mldo"; a missing supply skips PM-DVS for it.

  vdd-lldo1-supply:
    description: BUCK8 "vdd_lldo1"; a missing supply skips PM-DVS for it.

  vdd-lldo2-supply:
    description: BUCK9 "vdd_lldo2"; a missing supply skips PM-DVS for it.

  vdd-lldo3-supply:
    description: BUCK10 "vdd_lldo3"; a missing supply skips PM-DVS for it.

  samsung,acpm:
    $ref: /schemas/types.yaml#/definitions/phandle
    deprecated: true
    description:
      ACPM IPC node. Not used.

  samsung,sicd-veto:
    $ref: /schemas/types.yaml#/definitions/phandle-array
    maxItems: 96
    items:
      items:
        - description: node whose IP must be idle for SICD
        - description:
            busy predicate, include/dt-bindings/soc/samsung,exynos8895-pm.h;
            0 first clock enabled, 1 not runtime-suspended, 2 I2C bus lock
            held, 3 a PWM channel running. The first clock of a kind-0 node
            must be a gate of an always-on CMU registered without runtime PM.
          enum: [0, 1, 2, 3]
    description:
      The devices that must be idle before SICD. Without the property SICD is
      never entered. Entries whose node is disabled are ignored.

required:
  - compatible

additionalProperties: false

examples:
  - |
    #include <dt-bindings/soc/samsung,exynos8895-pm.h>

    power-management {
        compatible = "samsung,exynos8895-pm";
        vdd-mldo-supply = <&buck11_reg>;
        vdd-lldo1-supply = <&buck8_reg>;
        vdd-lldo2-supply = <&buck9_reg>;
        vdd-lldo3-supply = <&buck10_reg>;
        samsung,sicd-veto = <&pwm E8895_SICD_VETO_PWM>,
                            <&ufs E8895_SICD_VETO_CLK>,
                            <&hsi2c_1 E8895_SICD_VETO_I2C>,
                            <&mmc E8895_SICD_VETO_RPM>;
    };
```
