## Documentation/devicetree/bindings/misc/samsung,exynos8895-modem.txt
```
Samsung Exynos 8895 CP modem interface
======================================

The Exynos 8895 has an on-chip CP (Shannon 355, SS310AP family). Three nodes
describe its AP side: the AP<->CP mailbox, the layout of the memory the AP
shares with the CP, and the Samsung SIPC modem interface that boots the CP and
carries the IPC links. The drivers keep the vendor property names (mcu,*,
shmem,*, mif,*, mbx_*, sbi_*, iod,*); only properties added for this kernel
use the "samsung," prefix.

1. Mailbox
----------
Required properties:
- compatible: "samsung,exynos8895-mcu-ipc"
- reg: the mailbox register block
- interrupts: the CP->AP mailbox interrupt
- mcu,name: name of the mailbox
- mcu,id: mailbox id, 0 for the CP

2. Shared memory
----------------
Required properties:
- compatible: "samsung,exynos8895-shm-ipc"
- memory-region: the CP window and the CP RAM logging window
- memory-region-names: "modem_if", "cp_ram_logging"
- shmem,cp_size: size of the CP image area at the start of "modem_if"
- shmem,vss_size: size of the VSS area that follows it
- shmem,ipc_offset: offset of the IPC area in "modem_if" (the size of the
  boot area)
- shmem,ipc_size: size of the IPC area
- shmem,zmb_offset: offset of the zero-copy buffer area in "modem_if"
- shmem,zmb_size: size of the zero-copy buffer area
- samsung,acpm-dump: phandle of the APM SRAM node that the CP dump ioctl reads

3. Modem interface
------------------
The node must be a root node named "mif_pdata" with reg = <0x0 0x10000 0x0>.
The userspace CP boot daemon opens the platform device as
/sys/devices/platform/10000.mif_pdata/, and the start of the resource is the
offset of the CP main image in the boot area.

Required properties:
- compatible: "samsung,exynos8895-modem"
- reg: <0x0 0x10000 0x0>
- interrupts: CP fail (index 0) and CP watchdog (index 1)
- samsung,mailbox: phandle of the mailbox node
- samsung,shmem: phandle of the shared memory node
- samsung,pmu-syscon: phandle of the PMU system controller
- mif,name, mif,modem_net, mif,modem_type, mif,use_handover, mif,ipc_version,
  mif,link_types, mif,link_name, mif,link_attrs, mif,num_iodevs, mif,buff_offset,
  mif,buff_size, mif,bufpool_2nd_base, mif,bufpool_2nd_size: modem and link
  description
- mbx_ap2cp_msg, mbx_cp2ap_msg, mbx_ap2cp_united_status, mbx_cp2ap_united_status,
  mbx_ap2cp_mif_value, mbx_ap2cp_kerneltime, mbx_cp2ap_dvfsreq_cpu,
  mbx_cp2ap_dvfsreq_mif, mbx_cp2ap_dvfsreq_int: mailbox word numbers
- mif,int_ap2cp_msg, mif,int_ap2cp_wakeup, mif,int_ap2cp_status,
  mif,int_ap2cp_active: AP->CP doorbell numbers
- mif,irq_cp2ap_msg, mif,irq_cp2ap_status, mif,irq_cp2ap_active,
  mif,irq_cp2ap_wakelock, mif,irq_cp2ap_ratmode, mif,irq_cp2ap_perf_req_cpu,
  mif,irq_cp2ap_perf_req_mif, mif,irq_cp2ap_perf_req_int: CP->AP mailbox
  interrupt numbers
- sbi_*_mask, sbi_*_pos: mask and position of each field of the status words
- gpios: the hardware revision strap inputs; bit n of the revision is GPIO n

Required child node "iodevs", with one child per io device:
- iod,name: device node or network interface name
- iod,id: SIPC channel id
- iod,format: IPC format (0 FMT, 1 RAW, 2 RFS, 3 MULTI_RAW, 4 BOOT, 5 DUMP)
- iod,io_type: 0 misc device, 1 network device, 2 dummy
- iod,links: link type mask
- iod,attrs: attribute mask
- iod,ul_num_buffers, iod,ul_buffer_size, iod,dl_num_buffers,
  iod,dl_buffer_size: SBD ring geometry (with the SBD_IPC attribute)
Optional:
- iod,app: user of the device (informational)
- iod,napi_weight: NAPI weight of a network device
- iod,option_region: the device is created only when this equals
  CONFIG_OPTION_REGION (with the OPTION_REGION attribute)

Example:

	mcu_ipc_cp: mailbox@15b40000 {
		compatible = "samsung,exynos8895-mcu-ipc";
		reg = <0x15b40000 0x180>;
		interrupts = <GIC_SPI 97 IRQ_TYPE_LEVEL_HIGH>;
		mcu,name = "mcu_ipc_cp";
		mcu,id = <0>;
	};

	shmem_cp: shmem-ipc {
		compatible = "samsung,exynos8895-shm-ipc";
		memory-region = <&modem_mem>, <&cp_ram_logging_mem>;
		memory-region-names = "modem_if", "cp_ram_logging";
		shmem,cp_size = <0x7a00000>;
		shmem,vss_size = <0x600000>;
		shmem,ipc_offset = <0x8000000>;
		shmem,ipc_size = <0x500000>;
		shmem,zmb_offset = <0x8500000>;
		shmem,zmb_size = <0xb00000>;
		samsung,acpm-dump = <&apm_sram>;
	};

	mif_pdata {
		compatible = "samsung,exynos8895-modem";
		reg = <0x0 0x10000 0x0>;
		interrupts = <GIC_SPI 21 IRQ_TYPE_LEVEL_HIGH>,
			     <GIC_SPI 57 IRQ_TYPE_LEVEL_HIGH>;
		samsung,mailbox = <&mcu_ipc_cp>;
		samsung,shmem = <&shmem_cp>;
		samsung,pmu-syscon = <&pmu_system_controller>;
		mif,name = "ss355ap";
		mif,link_types = <0x200>;
		mif,link_name = "shmem";
		mif,num_iodevs = <20>;
		/* ... */

		iodevs {
			io_device_0 {
				iod,name = "umts_ipc0";
				iod,id = <0xeb>;
				iod,format = <0>;
				iod,io_type = <0>;
				iod,links = <0x200>;
				iod,attrs = <0x82>;
				iod,app = "RIL";
				iod,ul_num_buffers = <16>;
				iod,ul_buffer_size = <0x1000>;
				iod,dl_num_buffers = <32>;
				iod,dl_buffer_size = <0x1000>;
			};
		};
	};
```

## Documentation/devicetree/bindings/misc/samsung,exynos8895-vfsspi.yaml
```yaml
# SPDX-License-Identifier: (GPL-2.0-only OR BSD-2-Clause)
%YAML 1.2
---
$id: http://devicetree.org/schemas/misc/samsung,exynos8895-vfsspi.yaml#
$schema: http://devicetree.org/meta-schemas/core.yaml#

title: Synaptics VFS8xxx fingerprint sensor on a TEE-owned SPI (Exynos 8895)

maintainers:
  - nhansp <nhan.094.vn@gmail.com>

description:
  The fingerprint sensor of the Samsung Galaxy Note 8 sits on an SPI
  controller that the secure world owns and drives; the SPI node itself stays
  disabled. This node describes the non-secure side only, the sensor power
  enable, the data-ready interrupt and the SPI clocks the secure world needs.

properties:
  compatible:
    const: samsung,exynos8895-vfsspi

  interrupts:
    maxItems: 1
    description: data-ready (DRDY) interrupt, rising edge

  drdy-gpios:
    maxItems: 1
    description: data-ready line of the sensor, read to filter replayed edges

  ldo-gpios:
    maxItems: 1
    description: enable of the sensor's power supply

  clocks:
    minItems: 3
    items:
      - description: SPI controller bus clock
      - description: SPI controller functional clock gate
      - description: SPI functional clock divider, set to twice the SPI clock
      - description: Q-channel clock request of the SPI controller

  clock-names:
    minItems: 3
    items:
      - const: pclk
      - const: sclk_gate
      - const: sclk
      - const: qch

  spi-max-frequency:
    $ref: /schemas/types.yaml#/definitions/uint32
    description: SPI clock of the transfers the secure world runs
    maximum: 13000000

  samsung,orient:
    $ref: /schemas/types.yaml#/definitions/uint32
    enum: [0, 1]
    description: sensor orientation reported to userspace (0 normal, 1 upside down)

  samsung,detect-mode:
    $ref: /schemas/types.yaml#/definitions/uint32
    enum: [0, 1]
    description:
      1 = always-on detect mode, the data-ready interrupt stays a wakeup source
      while enabled; 0 = normal

  samsung,chip-id:
    $ref: /schemas/types.yaml#/definitions/string
    description: sensor name reported to userspace

  pinctrl-0: true
  pinctrl-1: true
  pinctrl-2: true

  pinctrl-names:
    items:
      - const: default
      - const: sleep
      - const: idle

required:
  - compatible
  - interrupts
  - drdy-gpios
  - ldo-gpios
  - clocks
  - clock-names

additionalProperties: false

examples:
  - |
    #include <dt-bindings/clock/samsung,exynos8895.h>
    #include <dt-bindings/gpio/gpio.h>
    #include <dt-bindings/interrupt-controller/irq.h>

    fingerprint {
        compatible = "samsung,exynos8895-vfsspi";
        interrupts-extended = <&gpa1 3 IRQ_TYPE_EDGE_RISING>;
        drdy-gpios = <&gpa1 3 GPIO_ACTIVE_HIGH>;
        ldo-gpios = <&gpe1 0 GPIO_ACTIVE_HIGH>;
        clocks = <&cmu_peric0 CLK_GOUT_PERIC0_USI00_I_PCLK>,
                 <&cmu_peric0 CLK_GOUT_PERIC0_USI00_I_SCLK_USI>,
                 <&cmu_top CLK_DOUT_CMU_PERIC0_USI00>,
                 <&cmu_peric0 CLK_GOUT_PERIC0_USI00_QCH>;
        clock-names = "pclk", "sclk_gate", "sclk", "qch";
        assigned-clocks = <&cmu_top CLK_MOUT_CMU_PERIC0_USI00>,
                          <&cmu_top CLK_DOUT_CMU_PERIC0_USI00>;
        assigned-clock-parents = <&oscclk>, <0>;
        assigned-clock-rates = <0>, <26000000>;
        spi-max-frequency = <13000000>;
        samsung,orient = <1>;
        samsung,detect-mode = <1>;
        samsung,chip-id = "NAMSAN";
        pinctrl-names = "default", "sleep", "idle";
        pinctrl-0 = <&spi2_bus &btp_irq &btp_ldo>;
        pinctrl-1 = <&btp_irqsleep>;
        pinctrl-2 = <&btp_irqidle>;
    };
```

## Documentation/devicetree/bindings/net/bluetooth/samsung,bcm43xx.yaml
```yaml
# SPDX-License-Identifier: (GPL-2.0-only OR BSD-2-Clause)
%YAML 1.2
---
$id: http://devicetree.org/schemas/net/bluetooth/samsung,bcm43xx.yaml#
$schema: http://devicetree.org/meta-schemas/core.yaml#

title: Broadcom BCM43xx Bluetooth power and low-power control on Samsung Exynos SoCs

maintainers:
  - nhansp <nhan.094.vn@gmail.com>

description: |
  Broadcom BCM43xx Bluetooth chip connected to Samsung Exynos UART with
  power enable (BT_EN), host wake (BT_HOST_WAKE), and wake (BT_WAKE) GPIO lines.
  Local binding for the greatlte port (spec L6D 4.4).

properties:
  compatible:
    const: samsung,bcm43xx

  bt-en-gpios:
    maxItems: 1
    description: GPIO specifier for the BT_EN power enable line

  bt-wake-gpios:
    maxItems: 1
    description: GPIO specifier for the BT_WAKE device wake line

  bt-host-wake-gpios:
    maxItems: 1
    description: GPIO specifier for the BT_HOST_WAKE host wake line

  interrupts-extended:
    maxItems: 1
    description: Interrupt specifier for the BT_HOST_WAKE line

  samsung,uart:
    $ref: /schemas/types.yaml#/definitions/phandle
    description: Phandle to the UART device node used for Bluetooth HCI transport

  pinctrl-names:
    items:
      - const: default

  pinctrl-0:
    minItems: 1
    maxItems: 3
    description: Pin control states for host-wake, bt-wake, and bt-en pins

required:
  - compatible
  - bt-en-gpios
  - bt-wake-gpios
  - bt-host-wake-gpios
  - interrupts-extended
  - samsung,uart

additionalProperties: false

examples:
  - |
    #include <dt-bindings/gpio/gpio.h>
    #include <dt-bindings/interrupt-controller/irq.h>

    bluetooth {
        compatible = "samsung,bcm43xx";
        bt-en-gpios = <&gpj1 7 GPIO_ACTIVE_HIGH>;
        bt-wake-gpios = <&gpj1 4 GPIO_ACTIVE_HIGH>;
        bt-host-wake-gpios = <&gpa2 3 GPIO_ACTIVE_HIGH>;
        interrupts-extended = <&gpa2 3 IRQ_TYPE_EDGE_BOTH>;
        samsung,uart = <&serial_1>;
        pinctrl-names = "default";
        pinctrl-0 = <&bt_hostwake &bt_btwake &bt_en>;
    };
```

## Documentation/devicetree/bindings/net/nfc/samsung,sec-nfc.txt
```
Samsung sec-nfc NFC controller (S3NRN82, Samsung raw-NCI driver)
===============================================================

The Samsung NFC controller of the Galaxy Note 8, driven by the transplanted
stock sec_nfc driver (drivers/nfc/sec_nfc.c). The driver exposes the chip as
the misc device /dev/sec-nfc for the vendor NFC HAL (raw NCI, firmware
download in bootloader mode); it does not use the kernel NFC/NCI stack, unlike
samsung,s3fwrn5. The stock property names are kept (they carry no registered
vendor prefix, so this is a text binding).

Required properties:
- compatible: "samsung,sec-nfc"
- reg: I2C address (0x27)
- interrupts: the NFC interrupt (IRQ_TYPE_EDGE_RISING), with interrupt-parent
- sec-nfc,ven-gpio: VEN power enable, output; high = off, low = on
- sec-nfc,irq-gpio: the interrupt line as a GPIO (its level is checked in the
  interrupt thread)
- sec-nfc,firm-gpio: firmware-download / wake pin, output

Optional properties:
- sec-nfc,nfc_ap_clk: the chip uses the AP reference clock; then required:
  - sec-nfc,clk_req-gpio: the chip's clock-request line (both edges)
  - clocks, clock-names = "oscclk_nfc": the reference clock (Exynos8895 PMU
    CLKOUT1, <&pmu_system_controller 1>)
- sec-nfc,ldo_control: the driver switches the I/O supply on at probe
  (except in LPM charging); then required:
  - nfc-pvdd-supply: the 1.8 V supply
  - sec-nfc,nfc_pvdd: the stock rail name string (logged only)
- pinctrl-names: "default"; pinctrl-0: the VEN and FIRM pin states

Example: arch/arm64/boot/dts/exynos/exynos8895-greatlte-l6i.dtsi (nfc@27).
```

## Documentation/devicetree/bindings/net/wireless/samsung,brcm-wlan.yaml
```yaml
# SPDX-License-Identifier: (GPL-2.0-only OR BSD-2-Clause)
%YAML 1.2
---
$id: http://devicetree.org/schemas/net/wireless/samsung,brcm-wlan.yaml#
$schema: http://devicetree.org/meta-schemas/core.yaml#

title: Samsung Broadcom WLAN platform glue

maintainers:
  - nhansp <nhan.094.vn@gmail.com>

description:
  Platform node for a Broadcom BCM4361 Wi-Fi module behind the Exynos PCIe
  host, driven by the bcmdhd4361 transplant glue (dhd_custom_exynos8895.c).

properties:
  compatible:
    const: samsung,brcm-wlan

  wlan-reg-on-gpios:
    maxItems: 1
    description: GPIO driving WLAN_REG_ON (active high).

  interrupts-extended:
    maxItems: 1
    description: WLAN_HOST_WAKE out-of-band IRQ from the module.

  samsung,pcie:
    $ref: /schemas/types.yaml#/definitions/phandle
    description: Phandle of the PCIe RC this module hangs off.

  pinctrl-names:
    const: default

  pinctrl-0:
    description: Pin control for WLAN_REG_ON and WLAN_HOST_WAKE.

required:
  - compatible
  - wlan-reg-on-gpios
  - interrupts-extended
  - samsung,pcie

additionalProperties: false

examples:
  - |
    #include <dt-bindings/gpio/gpio.h>
    #include <dt-bindings/interrupt-controller/irq.h>

    wlan {
        compatible = "samsung,brcm-wlan";
        wlan-reg-on-gpios = <&gpj1 3 GPIO_ACTIVE_HIGH>;
        interrupts-extended = <&gpa0 7 IRQ_TYPE_EDGE_RISING>;
        samsung,pcie = <&pcie0>;
        pinctrl-names = "default";
        pinctrl-0 = <&cfg_wlanen &wlan_host_wake>;
        status = "okay";
    };
```
