## Documentation/devicetree/bindings/display/panel/samsung,s6e3ha6.yaml
```yaml
# SPDX-License-Identifier: GPL-2.0-only OR BSD-2-Clause
%YAML 1.2
---
$id: http://devicetree.org/schemas/display/panel/samsung,s6e3ha6.yaml#
$schema: http://devicetree.org/meta-schemas/core.yaml#

title: Samsung S6E3HA6 AMOLED DSI panel

description: |
  The S6E3HA6 is the display driver IC of the 1440x2960 AMOLED panel of the
  Samsung Galaxy Note 8 (greatlte). It runs in MIPI DSI command mode with
  four data lanes and VESA DSC (two slices of 720x40), and reports its
  tearing effect on a GPIO.

maintainers:
  - Krzysztof Kozlowski <krzk@kernel.org>

allOf:
  - $ref: panel-common.yaml#

properties:
  compatible:
    const: samsung,s6e3ha6

  reg:
    maxItems: 1

  reset-gpios: true

  te-gpios: true

  disp-det-gpios:
    maxItems: 1
    description:
      Panel detect / ESD line, high while the panel is connected and
      running.

  vddi3p0-supply:
    description: 3.0 V panel supply (VDD_DDI_3P0).

  vddi1p8-supply:
    description: 1.8 V I/O supply (VDD_DDI_1P8).

  vddi1p6-supply:
    description: 1.6 V core supply (VDD_DDI_1P6).

  width-mm: true
  height-mm: true

  dsu_en:
    $ref: /schemas/types.yaml#/definitions/uint32
    enum: [0, 1]
    description:
      Dynamic Screen Scaling (DSU) support flag (1 = enabled, 0 = disabled).

  dsu_number:
    $ref: /schemas/types.yaml#/definitions/uint32
    minimum: 1
    maximum: 5
    description:
      Number of active DSU resolution modes exposed from the DSU mode arrays.

  dsu_width:
    $ref: /schemas/types.yaml#/definitions/uint32-array
    minItems: 1
    maxItems: 5
    description:
      Horizontal active resolution (in pixels) for each DSU mode entry.

  dsu_height:
    $ref: /schemas/types.yaml#/definitions/uint32-array
    minItems: 1
    maxItems: 5
    description:
      Vertical active resolution (in pixels) for each DSU mode entry.

  dsu_dsc_width:
    $ref: /schemas/types.yaml#/definitions/uint32-array
    minItems: 1
    maxItems: 5
    description:
      DSC slice width (in pixels) for each DSU mode entry.

  dsu_dsc_height:
    $ref: /schemas/types.yaml#/definitions/uint32-array
    minItems: 1
    maxItems: 5
    description:
      DSC slice height (in lines) for each DSU mode entry.

  dsu_dsc_en:
    $ref: /schemas/types.yaml#/definitions/uint32-array
    minItems: 1
    maxItems: 5
    description:
      DSC enable flag (1 = enabled, 0 = disabled) for each DSU mode entry.

  port: true

required:
  - compatible
  - reg
  - reset-gpios
  - vddi3p0-supply
  - vddi1p8-supply
  - vddi1p6-supply

unevaluatedProperties: false

examples:
  - |
    #include <dt-bindings/gpio/gpio.h>

    dsi {
        #address-cells = <1>;
        #size-cells = <0>;

        panel@0 {
            compatible = "samsung,s6e3ha6";
            reg = <0>;
            reset-gpios = <&gpa0 5 GPIO_ACTIVE_LOW>;
            disp-det-gpios = <&gpi1 1 GPIO_ACTIVE_HIGH>;
            te-gpios = <&gpb0 1 GPIO_ACTIVE_HIGH>;
            vddi3p0-supply = <&s2dos03_ldo3>;
            vddi1p8-supply = <&s2dos03_ldo1>;
            vddi1p6-supply = <&s2dos03_buck1>;
            width-mm = <71>;
            height-mm = <145>;

            port {
                panel_in: endpoint {
                    remote-endpoint = <&dsi_out>;
                };
            };
        };
    };

...
```

## Documentation/devicetree/bindings/display/samsung/samsung,exynos8895-decon.yaml
```yaml
# SPDX-License-Identifier: (GPL-2.0-only OR BSD-2-Clause)
%YAML 1.2
---
$id: http://devicetree.org/schemas/display/samsung/samsung,exynos8895-decon.yaml#
$schema: http://devicetree.org/meta-schemas/core.yaml#

title: Samsung Exynos8895 SoC Display and Enhancement Controller (DECON0)

maintainers:
  - Krzysztof Kozlowski <krzk@kernel.org>

description: |
  DECON0 ("decon_f") of the Exynos8895 blends up to six windows and drives a
  MIPI DSI interface, optionally through two DSC encoders. Unlike earlier
  DECONs it has no window DMA of its own: each window is fed by one of six
  DPP/IDMA channels (G0, G1, VG0, VG1, VGF0, VGF1), whose register blocks
  (DPP and DPU_DMA) are part of this node. The channels share the display
  System MMUs, so this device is their only IOMMU master.

properties:
  compatible:
    const: samsung,exynos8895-decon

  reg:
    items:
      - description: DECON0 registers, including the DSC encoders
      - description: DPP registers of the six channels
      - description: DPU_DMA common and channel registers

  reg-names:
    items:
      - const: decon
      - const: dpp
      - const: dma

  interrupts:
    minItems: 5
    maxItems: 15

  interrupt-names:
    minItems: 5
    items:
      - const: frame_start
      - const: frame_done
      - const: extra
      - const: g0_dma
      - const: g0_dpp
      - const: g1_dma
      - const: g1_dpp
      - const: vg0_dma
      - const: vg0_dpp
      - const: vg1_dma
      - const: vg1_dpp
      - const: vgf0_dma
      - const: vgf0_dpp
      - const: vgf1_dma
      - const: vgf1_dpp

  clocks:
    maxItems: 5

  clock-names:
    items:
      - const: aclk
      - const: dpp_g0
      - const: dma_sfr
      - const: dma_ch1
      - const: sysreg

  iommus:
    minItems: 1
    maxItems: 3

  memory-region:
    maxItems: 1
    description:
      The boot loader's framebuffer, identity-mapped for the IOMMU (it
      carries iommu-addresses for this device) so a scan-out left running
      by the boot loader stays valid when translation is enabled.

  power-domains:
    maxItems: 1

  pinctrl-0: true
  pinctrl-1: true

  pinctrl-names:
    items:
      - const: default
      - const: sleep

  samsung,disp-sysreg:
    $ref: /schemas/types.yaml#/definitions/phandle
    description:
      Phandle to the DPU0 system register block (TE source, DSIM mux, bus
      clock gating control).

  ports:
    $ref: /schemas/graph.yaml#/properties/ports
    description:
      Contains a port connected to the DSI host.

    properties:
      port@0:
        $ref: /schemas/graph.yaml#/properties/port

    required:
      - port@0

required:
  - compatible
  - reg
  - reg-names
  - interrupts
  - interrupt-names
  - clocks
  - clock-names
  - power-domains
  - samsung,disp-sysreg
  - ports

additionalProperties: false

examples:
  - |
    #include <dt-bindings/clock/samsung,exynos8895.h>
    #include <dt-bindings/interrupt-controller/arm-gic.h>

    display-controller@12860000 {
        compatible = "samsung,exynos8895-decon";
        reg = <0x12860000 0x10000>,
              <0x12851000 0x6000>,
              <0x128b0000 0x7000>;
        reg-names = "decon", "dpp", "dma";
        interrupts = <GIC_SPI 143 IRQ_TYPE_LEVEL_HIGH>,
                     <GIC_SPI 144 IRQ_TYPE_LEVEL_HIGH>,
                     <GIC_SPI 149 IRQ_TYPE_LEVEL_HIGH>,
                     <GIC_SPI 183 IRQ_TYPE_LEVEL_HIGH>,
                     <GIC_SPI 179 IRQ_TYPE_LEVEL_HIGH>;
        interrupt-names = "frame_start", "frame_done", "extra",
                          "g0_dma", "g0_dpp";
        clocks = <&cmu_dpu0 CLK_GOUT_DPU0_DECON0_ACLK>,
                 <&cmu_dpu0 CLK_GOUT_DPU0_DPP_DPP_G0_ACLK>,
                 <&cmu_dpu0 CLK_GOUT_DPU0_DPU_DMA_ACLK_SFR>,
                 <&cmu_dpu0 CLK_GOUT_DPU0_DPU_DMA_ACLK_CH1>,
                 <&cmu_dpu0 CLK_GOUT_DPU0_SYSREG_DPU0_PCLK>;
        clock-names = "aclk", "dpp_g0", "dma_sfr", "dma_ch1", "sysreg";
        power-domains = <&pd_dpu0>;
        iommus = <&sysmmu_dpu0>, <&sysmmu_dpu1>, <&sysmmu_dpu2>;
        memory-region = <&splash_mem>;
        samsung,disp-sysreg = <&syscon_dpu0>;
        pinctrl-names = "default", "sleep";
        pinctrl-0 = <&decon_f_te_on>;
        pinctrl-1 = <&decon_f_te_off>;

        ports {
            #address-cells = <1>;
            #size-cells = <0>;

            port@0 {
                reg = <0>;

                decon_to_dsi: endpoint {
                    remote-endpoint = <&dsi_from_decon>;
                };
            };
        };
    };
```

## Documentation/devicetree/bindings/firmware/samsung,exynos-seclog.yaml
```yaml
# SPDX-License-Identifier: (GPL-2.0-only OR BSD-2-Clause)
%YAML 1.2
---
$id: http://devicetree.org/schemas/firmware/samsung,exynos-seclog.yaml#
$schema: http://devicetree.org/meta-schemas/core.yaml#

title: Samsung Exynos secure-world log

maintainers:
  - Krzysztof Kozlowski <krzk@kernel.org>

description: |
  Samsung's EL3 monitor and its loadable firmwares (LDFW) write log messages
  into per-CPU rings in a reserved memory region and raise an interrupt; the
  normal world prints them. Local binding of the greatlte port (spec L6T 4,
  5.12), not for upstream.

properties:
  compatible:
    const: samsung,exynos-seclog

  interrupts:
    maxItems: 1

  memory-region:
    maxItems: 1
    description: the no-map reserved region that holds the log rings

required:
  - compatible
  - interrupts
  - memory-region

additionalProperties: false

examples:
  - |
    #include <dt-bindings/interrupt-controller/arm-gic.h>

    seclog {
        compatible = "samsung,exynos-seclog";
        interrupts = <GIC_SPI 68 IRQ_TYPE_EDGE_RISING>;
        memory-region = <&seclog_mem>;
    };
```

## Documentation/devicetree/bindings/firmware/samsung,exynos-tee.yaml
```yaml
# SPDX-License-Identifier: (GPL-2.0-only OR BSD-2-Clause)
%YAML 1.2
---
$id: http://devicetree.org/schemas/firmware/samsung,exynos-tee.yaml#
$schema: http://devicetree.org/meta-schemas/core.yaml#

title: Trustonic Kinibi TEE (MobiCore) on Samsung Exynos SoCs

maintainers:
  - Krzysztof Kozlowski <krzk@kernel.org>

description: |
  Normal-world side of the Trustonic Kinibi ("t-base", MobiCore) trusted
  execution environment that Samsung's EL3 firmware starts on Exynos SoCs.
  The driver talks to it with SMC fast calls; the secure world notifies the
  normal world through one interrupt (S-SIQ). Local binding of the greatlte
  port (spec L6T 4), not for upstream.

properties:
  compatible:
    const: samsung,exynos-tee

  interrupts:
    maxItems: 1
    description: S-SIQ, the secure world's notification interrupt

required:
  - compatible
  - interrupts

additionalProperties: false

examples:
  - |
    #include <dt-bindings/interrupt-controller/arm-gic.h>

    tee {
        compatible = "samsung,exynos-tee";
        interrupts = <GIC_SPI 233 IRQ_TYPE_EDGE_RISING>;
    };
```

## Documentation/devicetree/bindings/firmware/samsung,ufs-srpmb.yaml
```yaml
# SPDX-License-Identifier: (GPL-2.0-only OR BSD-2-Clause)
%YAML 1.2
---
$id: http://devicetree.org/schemas/firmware/samsung,ufs-srpmb.yaml#
$schema: http://devicetree.org/meta-schemas/core.yaml#

title: Samsung Exynos secure RPMB proxy

maintainers:
  - nhansp <nhan.094.vn@gmail.com>

description: |
  The Exynos secure world places RPMB requests in a buffer shared with the
  normal world and raises an interrupt. The normal world forwards them to the
  RPMB well-known logical unit of the UFS device and writes the result back.

properties:
  compatible:
    const: samsung,ufs-srpmb

  interrupts:
    maxItems: 1
    description: request interrupt raised by the secure world

  samsung,ufs:
    $ref: /schemas/types.yaml#/definitions/phandle
    description: UFS host controller whose RPMB well-known LU serves the requests

required:
  - compatible
  - interrupts
  - samsung,ufs

additionalProperties: false

examples:
  - |
    #include <dt-bindings/interrupt-controller/arm-gic.h>

    ufs-srpmb {
        compatible = "samsung,ufs-srpmb";
        interrupts = <GIC_SPI 69 IRQ_TYPE_EDGE_RISING>;
        samsung,ufs = <&ufs>;
    };
```

## Documentation/devicetree/bindings/gpu/samsung,exynos8895-mali.yaml
```yaml
# SPDX-License-Identifier: (GPL-2.0-only OR BSD-2-Clause)
%YAML 1.2
---
$id: http://devicetree.org/schemas/gpu/samsung,exynos8895-mali.yaml#
$schema: http://devicetree.org/meta-schemas/core.yaml#

title: Arm Mali-G71 GPU of the Samsung Exynos 8895 (vendor kbase driver)

maintainers:
  - Krzysztof Kozlowski <krzk@kernel.org>

description: |
  Mali-G71 (tMIx) of the Exynos 8895, driven by Arm's vendor kbase r16p0
  driver that the stock userspace GLES blob requires. Not the Panfrost
  binding (arm,mali-bifrost.yaml): the interrupt names are the upper-case
  names of the stock device tree. Power through the pd_g3d power domain,
  the core clock through the ACPM DVFS G3D domain, no supply (the power
  management firmware owns the rail). The node is named mali@<reg>, not
  gpu@<reg>, as the stock device tree does (FDT:4636): the platform device
  directory the power HAL writes the DVFS locks in is
  /sys/devices/platform/13900000.mali. Local binding of the greatlte port
  (spec L6A_graphics.md 4.1), not for upstream.

properties:
  compatible:
    const: samsung,exynos8895-mali

  reg:
    maxItems: 1

  interrupts:
    items:
      - description: Job interrupt
      - description: MMU interrupt
      - description: GPU interrupt

  interrupt-names:
    items:
      - const: JOB
      - const: MMU
      - const: GPU

  clocks:
    maxItems: 1

  clock-names:
    const: clk_mali

  power-domains:
    maxItems: 1

  operating-points-v2: true

  "#cooling-cells":
    const: 2

  samsung,autosuspend-delay-ms:
    $ref: /schemas/types.yaml#/definitions/uint32
    description: runtime-PM autosuspend delay of the GPU, in milliseconds
    default: 50

required:
  - compatible
  - reg
  - interrupts
  - interrupt-names
  - clocks
  - clock-names
  - power-domains
  - operating-points-v2

additionalProperties: false

examples:
  - |
    #include <dt-bindings/interrupt-controller/arm-gic.h>

    mali@13900000 {
        compatible = "samsung,exynos8895-mali";
        reg = <0x13900000 0x5000>;
        interrupts = <GIC_SPI 60 IRQ_TYPE_LEVEL_HIGH>,
                     <GIC_SPI 61 IRQ_TYPE_LEVEL_HIGH>,
                     <GIC_SPI 59 IRQ_TYPE_LEVEL_HIGH>;
        interrupt-names = "JOB", "MMU", "GPU";
        power-domains = <&pd_g3d>;
        clocks = <&acpm_ipc 4>;
        clock-names = "clk_mali";
        operating-points-v2 = <&gpu_opp_table>;
        #cooling-cells = <2>;
        samsung,autosuspend-delay-ms = <50>;
    };
```

## Documentation/devicetree/bindings/iio/health/maxim,max86902-hrm.txt
```
Maxim MAX8690x heart-rate sensor (Samsung input driver)
=======================================================

The MAX86900/86902/86907/86909 family driver of Samsung
(drivers/optics/hrmsensor.c + hrm_max86902.c); the Galaxy Note 8 carries a
MAX86907. It reports as the input device hrm_sensor with Samsung sysfs nodes,
unlike the upstream IIO maxim,max30102 binding. The transplanted parser reads
the stock hrmsensor,* names.

Required properties:
- compatible: "maxim,max86902-hrm"
- reg: I2C address (0x57)
- hrmsensor,hrm_int-gpio: the interrupt line; the driver derives the interrupt
  from it and requests it falling-edge
- vdd-1p8-supply: 1.8 V sensor supply
- led-3p3-supply: 3.3 V LED supply
- i2c-1p8-supply: 1.8 V I2C pull-up supply (kept on once enabled)

Optional properties:
- hrmsensor,vdd_1p8, hrmsensor,led_3p3, hrmsensor,i2c_1p8: the stock rail name
  strings (logged only)
- pinctrl-names: "default", "sleep", "idle"; pinctrl-0..2: the interrupt pin
  states

Example: arch/arm64/boot/dts/exynos/exynos8895-greatlte-l6c.dtsi (hrm@57).
```
