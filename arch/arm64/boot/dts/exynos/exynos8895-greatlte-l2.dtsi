// SPDX-License-Identifier: GPL-2.0 OR BSD-3-Clause
/*
 * Samsung Galaxy Note 8 (greatlte, SM-N950N) board DT, part "l2":
 * L2 power: ACPM, PMIC rails, DVFS/OPP, TMU board parts (L2 4.2-4.6).
 *
 * Included at the end of exynos8895-greatlte.dts, after L0's nodes, in the merge
 * order of FULL_IMAGE_PLAN.md 2.2. Owner: WP-L2; no other work package edits this
 * file (plan 2.3 rule D1). A node that two parts both configure (&usi9, &usi10)
 * is written identically in both files: dtc lets the later file win on a differing
 * value, which gl-verify V-DUP reports as an error. L0's reserved-memory stays in
 * the .dts; carveout additions and flag changes are &label edits here (plan X-8).
 */

/*
 * ACPM, the APM firmware interface (spec/L2_power.md 4.2, 5.1-5.2): the AP2APM mailbox, the
 * APM SRAM with the channel table and the ACPM node. Its probe attaches the DVFS plugin and
 * registers the ACPM DVFS clocks that cpufreq-dt uses. Stock: FDT:6674-6701 (acpm, acpm_ipc,
 * acpm_dvfs, all enabled on greatlte).
 */
&ap2apm_mailbox { status = "okay"; };
&apm_sram { status = "okay"; };
&acpm_ipc { status = "okay"; };
