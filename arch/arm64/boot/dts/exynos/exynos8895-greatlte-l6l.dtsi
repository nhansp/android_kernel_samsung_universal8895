// SPDX-License-Identifier: GPL-2.0 OR BSD-3-Clause
/*
 * Samsung Galaxy Note 8 (greatlte, SM-N950N) board DT, part "l6l":
 * Exynos 8895 2D graphic accelerator (G2D) blitter + SysMMUs (spec L6L 4.2).
 *
 * The stock HWC (libacryl) uses /dev/fimg2d for everyday composition, not only
 * for DisplayPort (hardware log 2026-10-02: "Failed to open /dev/fimg2d" on every
 * frame), so the G2D is enabled now (user decision 2026-10-02, DECISIONS.md).
 */

&cmu_g2d {
	status = "okay";
};

&sysmmu_g2dd0 {
	status = "okay";
};

&sysmmu_g2dd1 {
	status = "okay";
};

&g2d {
	status = "okay";
};
