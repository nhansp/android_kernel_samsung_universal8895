// SPDX-License-Identifier: GPL-2.0 OR BSD-3-Clause
/*
 * Samsung Galaxy Note 8 (greatlte, SM-N950N) board DT, part "l6com":
 * L6 common: aliases, CMA carveouts, SPI, SMC, sec class (plan 2.2 row 7).
 *
 * Included at the end of exynos8895-greatlte.dts, after L0's nodes, in the merge
 * order of FULL_IMAGE_PLAN.md 2.2. Owner: WP-L6COM; no other work package edits this
 * file (plan 2.3 rule D1). A node that two parts both configure (&usi9, &usi10)
 * is written identically in both files: dtc lets the later file win on a differing
 * value, which gl-verify V-DUP reports as an error. L0's reserved-memory stays in
 * the .dts; carveout additions and flag changes are &label edits here (plan X-8).
 */

/*
 * L6 bus aliases (L6_rest 4.0, L6F 4.1; serial1 is L6D's, plan X-35). ACK has only
 * pinctrl aliases; with these the buses keep the stock numbers (an I2C bus number comes
 * from an "i2c" alias, A:drivers/i2c/i2c-core-base.c:1658; an SPI bus number from an "spi"
 * alias, A:drivers/spi/spi.c:3282), so stock log names such as 32-0066 stay valid.
 */
/ {
	aliases {
		i2c10 = &hsi2c_10;	/* S Pen: FDT:4181 hsi2c10 = "/hsi2c@10490000" */
		i2c11 = &hsi2c_11;	/* amp: FDT:4182 hsi2c11 = "/hsi2c@104A0000" */
		i2c23 = &hsi2c_23;	/* touch: FDT:4194 hsi2c23 = "/hsi2c@108E0000" */
		i2c25 = &hsi2c_25;	/* S2MPB02 flash LED: FDT:4196 hsi2c25 = "/hsi2c@10900000" */
		i2c26 = &hsi2c_26;	/* NFC, HRM: FDT:4197 hsi2c26 = "/hsi2c@10910000" */
		i2c29 = &hsi2c_29;	/* IDT receiver: FDT:4200 hsi2c29 = "/hsi2c@10940000" */
		i2c30 = &hsi2c_30;	/* S2MM005: FDT:4201 hsi2c30 = "/hsi2c@10950000" */
		i2c32 = &hsi2c_32;	/* MAX77865: FDT:4203 hsi2c32 = "/hsi2c@10970000" */
		spi3 = &spi_3;		/* codec: FDT:4207 spi3 = "/spi@10460000" */
		spi10 = &spi_10;	/* sensor hub: FDT:4214 spi10 = "/spi@108C0000" */
	};
};
