## drivers/staging/android/ion_legacy/Kconfig
```kconfig
# SPDX-License-Identifier: GPL-2.0
config ION_LEGACY_EXYNOS
	bool "Legacy Exynos ION ABI (/dev/ion)"
	depends on DMA_SHARED_BUFFER && DMA_CMA && OF_RESERVED_MEM
	select EXYNOS8895_SMC
	help
	  Provides /dev/ion with the ION user ABI of the Samsung Exynos 4.4
	  kernels: client handles, ION_IOC_ALLOC, FREE, SHARE, MAP, IMPORT,
	  SYNC and SYNC_PARTIAL, and the 32-bit compat ioctls. Buffers come
	  from the page allocator and from the reusable CMA regions and
	  secure carveouts named in the "samsung,exynos8895-ion-legacy" DT
	  node, and are exported as dma-bufs. Secure carveout buffers are
	  protected through EL3.

	  Needed by prebuilt Exynos 8895 userspace that uses libion_exynos,
	  such as the Samsung gralloc and camera HAL.
```

## drivers/ufs/host/Kconfig
```kconfig
# SPDX-License-Identifier: GPL-2.0+
#
# Kernel configuration file for the UFS host controller drivers.
#
# Copyright (C) 2011-2013 Samsung India Software Operations
#
# Authors:
#	Santosh Yaraganavi <santosh.sy@samsung.com>
#	Vinayak Holikatti <h.vinayak@samsung.com>

config SCSI_UFSHCD_PCI
	tristate "PCI bus based UFS Controller support"
	depends on PCI
	help
	  This selects the PCI UFS Host Controller Interface. Select this if
	  you have UFS Host Controller with PCI Interface.

	  If you have a controller with this interface, say Y or M here.

	  If unsure, say N.

config SCSI_UFS_DWC_TC_PCI
	tristate "DesignWare pci support using a G210 Test Chip"
	depends on SCSI_UFSHCD_PCI
	help
	  Synopsys Test Chip is a PHY for prototyping purposes.

	  If unsure, say N.

config SCSI_UFSHCD_PLATFORM
	tristate "Platform bus based UFS Controller support"
	depends on HAS_IOMEM
	help
	  This selects the UFS host controller support. Select this if
	  you have an UFS controller on Platform bus.

	  If you have a controller with this interface, say Y or M here.

	  If unsure, say N.

config SCSI_UFS_CDNS_PLATFORM
	tristate "Cadence UFS Controller platform driver"
	depends on SCSI_UFSHCD_PLATFORM
	help
	  This selects the Cadence-specific additions to UFSHCD platform driver.

	  If unsure, say N.

config SCSI_UFS_DWC_TC_PLATFORM
	tristate "DesignWare platform support using a G210 Test Chip"
	depends on OF && SCSI_UFSHCD_PLATFORM
	help
	  Synopsys Test Chip is a PHY for prototyping purposes.

	  If unsure, say N.

config SCSI_UFS_QCOM
	tristate "QCOM specific hooks to UFS controller platform driver"
	depends on SCSI_UFSHCD_PLATFORM && ARCH_QCOM
	depends on GENERIC_MSI_IRQ
	depends on RESET_CONTROLLER
	select QCOM_INLINE_CRYPTO_ENGINE if SCSI_UFS_CRYPTO
	help
	  This selects the QCOM specific additions to UFSHCD platform driver.
	  UFS host on QCOM needs some vendor specific configuration before
	  accessing the hardware which includes PHY configuration and vendor
	  specific registers.

	  Select this if you have UFS controller on QCOM chipset.
	  If unsure, say N.

config SCSI_UFS_MEDIATEK
	tristate "Mediatek specific hooks to UFS controller platform driver"
	depends on SCSI_UFSHCD_PLATFORM && ARCH_MEDIATEK
	depends on PM
	depends on RESET_CONTROLLER
	select PHY_MTK_UFS
	select RESET_TI_SYSCON
	help
	  This selects the Mediatek specific additions to UFSHCD platform driver.
	  UFS host on Mediatek needs some vendor specific configuration before
	  accessing the hardware which includes PHY configuration and vendor
	  specific registers.

	  Select this if you have UFS controller on Mediatek chipset.

	  If unsure, say N.

config SCSI_UFS_HISI
	tristate "Hisilicon specific hooks to UFS controller platform driver"
	depends on (ARCH_HISI || COMPILE_TEST) && SCSI_UFSHCD_PLATFORM
	help
	  This selects the Hisilicon specific additions to UFSHCD platform driver.

	  Select this if you have UFS controller on Hisilicon chipset.
	  If unsure, say N.

config SCSI_UFS_RENESAS
	tristate "Renesas specific hooks to UFS controller platform driver"
	depends on (ARCH_RENESAS || COMPILE_TEST) && SCSI_UFSHCD_PLATFORM
	help
	  This selects the Renesas specific additions to UFSHCD platform driver.
	  UFS host on Renesas needs some vendor specific configuration before
	  accessing the hardware.

	  Select this if you have UFS controller on Renesas chipset.

	  If unsure, say N.

config SCSI_UFS_TI_J721E
	tristate "TI glue layer for Cadence UFS Controller"
	depends on OF && HAS_IOMEM && (ARCH_K3 || COMPILE_TEST)
	help
	  This selects driver for TI glue layer for Cadence UFS Host
	  Controller IP.

	  Selects this if you have TI platform with UFS controller.
	  If unsure, say N.

config SCSI_UFS_EXYNOS
	tristate "Exynos specific hooks to UFS controller platform driver"
	depends on SCSI_UFSHCD_PLATFORM && (ARCH_EXYNOS || COMPILE_TEST)
	help
	  This selects the Samsung Exynos SoC specific additions to UFSHCD
	  platform driver.  UFS host on Samsung Exynos SoC includes HCI and
	  UNIPRO layer, and associates with UFS-PHY driver.

	  Select this if you have UFS host controller on Samsung Exynos SoC.
	  If unsure, say N.

config SCSI_UFS_VARIABLE_SG_ENTRY_SIZE
	bool
	default y if SCSI_UFS_EXYNOS && SCSI_UFS_CRYPTO

config SCSI_UFS_SPRD
	tristate "Unisoc specific hooks to UFS controller platform driver"
	depends on SCSI_UFSHCD_PLATFORM && (ARCH_SPRD || COMPILE_TEST)
	help
	  This selects the Unisoc specific additions to UFSHCD platform driver.
	  UFS host on Unisoc needs some vendor specific configuration before
	  accessing the hardware which includes PHY configuration and vendor
	  specific registers.

	  Select this if you have UFS controller on Unisoc chipset.
	  If unsure, say N.

config SCSI_UFS_ROCKCHIP
	tristate "Rockchip UFS host controller driver"
	depends on SCSI_UFSHCD_PLATFORM && (ARCH_ROCKCHIP || COMPILE_TEST)
	help
	  This selects the Rockchip specific additions to UFSHCD platform driver.
	  UFS host on Rockchip needs some vendor specific configuration before
	  accessing the hardware which includes PHY configuration and vendor
	  specific registers.

	  Select this if you have UFS controller on Rockchip chipset.
	  If unsure, say N.

# WP-L4b: Exynos8895 FMP inline encryption (spec L4b_fmp_rng.md 5.3)
config SCSI_UFS_EXYNOS8895_FMP_VERIFIED
	bool "Exynos8895 FMP: advertise inline AES-256-XTS (key layout verified on hardware)"
	depends on SCSI_UFS_EXYNOS && SCSI_UFS_CRYPTO
	default n
	help
	  Switch the Exynos8895 UFS host to 128-byte PRDT entries (FMP
	  DESCTYPE 3) and advertise AES-256-XTS with 4096-byte data units to
	  blk-crypto, so that fscrypt can encrypt inline on "inlinecrypt"
	  mounts.

	  FMP only encrypts requests that carry a blk-crypto key, so an
	  unencrypted filesystem is stored as before; every transfer does use
	  the 128-byte PRDT format, as Samsung's kernel always did.

	  With N the host keeps the 16-byte PRDT and DESCTYPE 0, and fscrypt
	  uses the software fallback on "inlinecrypt" mounts. Both store the
	  same ciphertext, so a filesystem can move between the two.

config SCSI_UFS_EXYNOS8895_FMP_KAT
	bool "DEBUG: Exynos8895 FMP read-only known-answer test"
	depends on SCSI_UFS_EXYNOS=y && SCSI_UFS_CRYPTO && DEBUG_FS
	depends on GREATLTE_HB_L4B && CRYPTO_SKCIPHER=y
	default n
	help
	  Debug only (spec L4b 5.6, test T-L4b-2). Switches the Exynos8895
	  UFS host to 128-byte PRDT entries (FMP DESCTYPE 3) for every
	  transfer and adds the debugfs file greatlte-l4b/fmp_kat, which
	  reads one 4 KiB block through FMP with a test key in each
	  candidate key layout and compares the result with software
	  xts(aes). Only the test's own key is served natively: every other
	  key fails with -EIO while the layout is unverified. Never enable
	  in a release build; the first boot of such a kernel is read-only
	  (T-L4b-1a).
```

## drivers/usb/typec/Kconfig
```kconfig
# SPDX-License-Identifier: GPL-2.0

menuconfig TYPEC
	tristate "USB Type-C Support"
	help
	  USB Type-C Specification defines a cable and connector for USB where
	  only one type of plug is supported on both ends, i.e. there will not
	  be Type-A plug on one end of the cable and Type-B plug on the other.
	  Determination of the host-to-device relationship happens through a
	  specific Configuration Channel (CC) which goes through the USB Type-C
	  cable. The Configuration Channel may also be used to detect optional
	  Accessory Modes - Analog Audio and Debug - and if USB Power Delivery
	  is supported, the Alternate Modes, where the connector is used for
	  something else then USB communication.

	  USB Power Delivery Specification defines a protocol that can be used
	  to negotiate the voltage and current levels with the connected
	  partners. USB Power Delivery allows higher voltages then the normal
	  5V, up to 20V, and current up to 5A over the cable. The USB Power
	  Delivery protocol is also used to negotiate the optional Alternate
	  Modes when they are supported. USB Power Delivery does not depend on
	  USB Type-C connector, however it is mostly used together with USB
	  Type-C connectors.

	  USB Type-C and USB Power Delivery Specifications define a set of state
	  machines that need to be implemented in either software or firmware.
	  Simple USB Type-C PHYs, for example USB Type-C Port Controller
	  Interface Specification compliant "Port Controllers" need the state
	  machines to be handled in the OS, but stand-alone USB Type-C and Power
	  Delivery controllers handle the state machines inside their firmware.
	  The USB Type-C and Power Delivery controllers usually function
	  autonomously, and do not necessarily require drivers.

	  Enable this configurations option if you have USB Type-C connectors on
	  your system and 1) you know your USB Type-C hardware requires OS
	  control (a driver) to function, or 2) if you need to be able to read
	  the status of the USB Type-C ports in your system, or 3) if you need
	  to be able to swap the power role (decide are you supplying or
	  consuming power over the cable) or data role (host or device) when
	  both roles are supported.

	  For more information, see the kernel documentation for USB Type-C
	  Connector Class API (Documentation/driver-api/usb/typec.rst)
	  <https://www.kernel.org/doc/html/latest/driver-api/usb/typec.html>
	  and ABI (Documentation/ABI/testing/sysfs-class-typec).

if TYPEC

source "drivers/usb/typec/tcpm/Kconfig"

source "drivers/usb/typec/ucsi/Kconfig"

source "drivers/usb/typec/tipd/Kconfig"

config TYPEC_ANX7411
	tristate "Analogix ANX7411 Type-C DRP Port controller driver"
	depends on I2C
	depends on USB_ROLE_SWITCH
	depends on POWER_SUPPLY
	help
	  Say Y or M here if your system has Analogix ANX7411 Type-C DRP Port
	  controller driver.

	  If you choose to build this driver as a dynamically linked module, the
	  module will be called anx7411.ko.

config TYPEC_RT1719
	tristate "Richtek RT1719 Sink Only Type-C controller driver"
	depends on USB_ROLE_SWITCH || !USB_ROLE_SWITCH
	depends on I2C
	depends on POWER_SUPPLY
	select REGMAP_I2C
	help
	  Say Y or M here if your system has Richtek RT1719 sink only
	  Type-C port controller driver.

	  If you choose to build this driver as a dynamically linked module, the
	  module will be called rt1719.ko

config TYPEC_HD3SS3220
	tristate "TI HD3SS3220 Type-C DRP Port controller driver"
	depends on I2C
	depends on USB_ROLE_SWITCH
	help
	  Say Y or M here if your system has TI HD3SS3220 Type-C DRP Port
	  controller driver.

	  If you choose to build this driver as a dynamically linked module, the
	  module will be called hd3ss3220.ko.

config TYPEC_STUSB160X
	tristate "STMicroelectronics STUSB160x Type-C controller driver"
	depends on USB_ROLE_SWITCH || !USB_ROLE_SWITCH
	depends on I2C
	select REGMAP_I2C
	help
	  Say Y or M here if your system has STMicroelectronics STUSB160x
	  Type-C port controller.

	  If you choose to build this driver as a dynamically linked module, the
	  module will be called stusb160x.ko.

config TYPEC_WUSB3801
	tristate "Willsemi WUSB3801 Type-C port controller driver"
	depends on I2C
	select REGMAP_I2C
	help
	  Say Y or M here if your system has a WUSB3801 Type-C port controller.

	  If you choose to build this driver as a dynamically linked module, the
	  module will be called wusb3801.ko.

source "drivers/usb/typec/mux/Kconfig"

source "drivers/usb/typec/altmodes/Kconfig"

# L6G: Samsung Galaxy Note 8 (greatlte) MUIC and Type-C port controller (spec L6G 6.2)
config TYPEC_MAX77865_MUIC
	bool "Maxim MAX77865 MUIC (D+/D- switch) base driver"
	depends on I2C && OF && TYPEC=y
	select REGMAP_I2C
	select AUXILIARY_BUS
	help
	  The MUIC of the Maxim MAX77865 PMIC (I2C 0x25) as used on the Samsung
	  Galaxy Note 8: routes D+/D- to the application processor's USB or UART
	  and switches BC1.2 charger detection on and off for the S2MM005 port
	  controller driver. Creates the auxiliary device of the AFC/QC module.
	  It writes no high-voltage register. Built in only: it reads the
	  pmic_info= boot parameter from the saved command line.

config TYPEC_S2MM005
	tristate "Samsung S2MM005 USB Type-C / PD port controller"
	depends on I2C && OF && TYPEC && USB_ROLE_SWITCH && TYPEC_MAX77865_MUIC
	help
	  The S2MM005 port controller of the Samsung Galaxy Note 8. Its
	  firmware runs Type-C and USB Power Delivery; the driver reads the
	  attach state and reports it through the Type-C class, the USB role
	  switch and the MAX77865 MUIC. It never selects a PD voltage and never
	  switches VBUS on unless the two options below are set.

config TYPEC_S2MM005_OTG_VBUS
	bool "Switch the OTG VBUS boost on for a USB host session"
	depends on TYPEC_S2MM005
	default n
	help
	  Let the port controller switch the phone's 5 V OTG boost on for a
	  USB host session. Raises VBUS: see spec L6H 1A SAFETY row V1. Enable
	  only with the user present. Say N.

config TYPEC_S2MM005_PD_SELECT
	bool "USB-PD sink voltage selection (charging path, see L6H SAFETY)"
	depends on TYPEC_S2MM005
	default n
	help
	  Lets the charger request USB-PD source voltages above 5 V (PDO
	  selection and the alternate-mode power negotiation command).
	  Charging path: see spec L6H 1A SAFETY. Enable only with the user
	  present. Say N.

endif # TYPEC
```

## sound/soc/samsung/abox/Kconfig
```kconfig
config SND_SOC_SAMSUNG_ABOX
	tristate "ASoC support for Samsung ABOX Audio"
	depends on SND_SOC_SAMSUNG && EXYNOS_IOMMU && MFD_SYSCON
	select REGMAP_MMIO
	select SND_SOC_COMPRESS
	select EXYNOS8895_SMC
	help
	  Say Y or M if you want to add support for codecs attached to
	  the Samsung SoC ABOX interface. You will also need to
	  select the audio interfaces to support below.
```
